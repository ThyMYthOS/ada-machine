# Polarfire SoC register map
Vendor: Microchip; File version: 1.0
CPU: Microchip PolarFire SoC 1.0, little endian
Registers are 32-bit, read-write, reset 0x0 unless marked. A register's access mark holds for its fields unless they carry their own. Offsets are from the block's base; [hi:lo] are bit positions; lines under a group give offsets from that group; {n}, {i} and the like mark numbered series.

## DDR_CSR_APB (part 1 of 3) — DDR_CSR_APB Controller
Base 0x20082400
0x2400 CFG_MANUAL_ADDRESS_MAP
  [0] CFG_MANUAL_ADDRESS_MAP — Enables user selection of address mapping 0 - Default address mapping. Address mapping from l_addr based on settings of cfg_mem_rowbits, cfg_mem_colbits, as described in the SDRAM Controller User Guide. 1 - User selected address mapping. Address mapping from l_addr based on settings of cfg_chipaddr_map, cfg_rowaddr_map, cfg_bankaddr_map, cfg_coladdr_map, and cfg_cidaddr_map (DDR4 3DS)
0x2404 CFG_CHIPADDR_MAP
  [23:0] CFG_CHIPADDR_MAP — Four 6-bit quantities specifying how to map address bits from l_addr into the rank (chip select bits, sd_cs_n). bits 0-5 - Specify which bit of l_addr maps to chip address bit 0 bits 6-11 - Specifies which bit of l_addr maps to chip address bit 1 bits 12-17 - Specifies which bit of l_addr maps to chip address bit 2 bits 18-23 - Specifies which bit of l_addr maps to chip address bit 3
0x2408 CFG_CIDADDR_MAP
  [17:0] CFG_CIDADDR_MAP — Three 6-bit quantities specifying how to map address bits from l_addr into 3DS chip ID bits (sd_cid[2:0]). bits 0-5 - Specify which bit of l_addr maps to chip ID bit 0 bits 6-11 - Specifies which bit of l_addr maps to chip ID bit 1 bits 12-17 - Specifies which bit of l_addr maps to chip ID bit 2
0x240C CFG_MB_AUTOPCH_COL_BIT_POS_LOW reset 0x4
  [2:0] CFG_MB_AUTOPCH_COL_BIT_POS_LOW — This field together with the cfg_mb_autopch_col_bit_pos_high field set a contiguous column address region that allows customization of when auto precharge occurs within multiburst accesses. cfg_mb_autopch_col_bit_pos_low sets the low bit position of l_addr and cfg_mb_autopch_col_bit_pos_high sets the high bit position of l_addr bits that are used to define the last column address in an open bank. When the multiburst internal l_addr bits in the l_addr range defined by these two configuration fields are all one, an auto_precharge will be issued by the multiburst module internally for the sub-access. This field is unused if cfg_manual_address_map is set to 0. Setting this field to 0 disables this auto-precharge functionality. When it is used, the only valid values are a function of the memory technology being used as follows: DDR3 - 3 or 4. (3 is normal default) DDR4 - 3 or 4. (4 is normal default) HBM - 2,3,or 4 (4 is normal default)
0x2410 CFG_MB_AUTOPCH_COL_BIT_POS_HIGH reset 0xA
  [3:0] CFG_MB_AUTOPCH_COL_BIT_POS_HIGH — This field together with the cfg_mb_autopch_col_bit_pos_low field set a contiguous column address region that allows customization of when auto precharge occurs within multiburst accesses. cfg_mb_autopch_col_bit_pos_low sets the low bit position of l_addr and cfg_mb_autopch_col_bit_pos_high sets the high bit position of l_addr bits that are used to define the last column address in an open bank. When the multiburst internal l_addr bits in the l_addr range defined by these two configuration fields are all one, an auto_precharge will be issued by the multiburst module internally for the sub-access. This field is unused if if cfg_manual_address_map is set to 0. When it is used, the only valid values are a function of the memory technology being used as follows: DDR3 - cfg_mem_colbits-1 to 4. (cfg_mem_colbits-1 is the normal default) DDR4 - 10 to 4. (10 is the normal default) HBM - 8 to 4. (8 is the normal default)
0x2414 CFG_BANKADDR_MAP_0
  [31:0] CFG_BANKADDR_MAP_0 — Six 6-bit quantities specifying how to map address bits from l_addr into bank bits (sd_ba). bits 0-5 - Specify which bit of l_addr maps to bank address bit 0 (sd_ba[0]) bits 6-11 - Specifies which bit of l_addr maps to bank address bit 1 (sd_ba[1]) bits 12-17 - Specifies which bit of l_addr maps to bank address bit 2/group bit 0 (sd_ba[2], for HBM pseudo channel memory this is also the pseudo channel select bit) bits 18-23 - Specifies which bit of l_addr maps to bank address bit 3/group bit 1 (sd_ba[3]) bits 24-29 - Specifies which bit of l_addr maps to bank address bit 4/group bit 2 (sd_ba[4]) bits 30-35 - Specifies which bit of l_addr maps to bank address bit 5/group bit 3 (sd_ba[5], for HBM pseudo channel memory this is also the SID bank selection bit)
0x2418 CFG_BANKADDR_MAP_1
  [3:0] CFG_BANKADDR_MAP_1 — Six 6-bit quantities specifying how to map address bits from l_addr into bank bits (sd_ba). bits 0-5 - Specify which bit of l_addr maps to bank address bit 0 (sd_ba[0]) bits 6-11 - Specifies which bit of l_addr maps to bank address bit 1 (sd_ba[1]) bits 12-17 - Specifies which bit of l_addr maps to bank address bit 2/group bit 0 (sd_ba[2], for HBM pseudo channel memory this is also the pseudo channel select bit) bits 18-23 - Specifies which bit of l_addr maps to bank address bit 3/group bit 1 (sd_ba[3]) bits 24-29 - Specifies which bit of l_addr maps to bank address bit 4/group bit 2 (sd_ba[4]) bits 30-35 - Specifies which bit of l_addr maps to bank address bit 5/group bit 3 (sd_ba[5], for HBM pseudo channel memory this is also the SID bank selection bit)
{0x241C+4i} CFG_ROWADDR_MAP_{i} (i=0..2)
  [31:0] CFG_ROWADDR_MAP_{i} — Eighteen 6-bit quantities specifying how to map address bits from l_addr into row bits (sd_a, during activate command). bits 0-5 - Specify which bit of l_addr maps to row address bit 0 bits 6-11 - Specifies which bit of l_addr maps to row address bit 1 ... bits 6*x-6*x+5 - Specifies which bit of l_addr maps to row address bit x Note: When 6'd00 is used, it means a hard-coded zero (not l_addr[0]) except in the case where zero is used in the lower 9 rowaddr bit selections, in which case it refers to l_addr[0].
0x2428 CFG_ROWADDR_MAP_3
  [11:0] CFG_ROWADDR_MAP_3 — Eighteen 6-bit quantities specifying how to map address bits from l_addr into row bits (sd_a, during activate command). bits 0-5 - Specify which bit of l_addr maps to row address bit 0 bits 6-11 - Specifies which bit of l_addr maps to row address bit 1 ... bits 6*x-6*x+5 - Specifies which bit of l_addr maps to row address bit x Note: When 6'd00 is used, it means a hard-coded zero (not l_addr[0]) except in the case where zero is used in the lower 9 rowaddr bit selections, in which case it refers to l_addr[0].
{0x242C+4i} CFG_COLADDR_MAP_{i} (i=0..2)
  [31:0] CFG_COLADDR_MAP_{i} — Sixteen 6-bit quantities specifying how to map address bits from l_addr into row bits (sd_a, during read/write commands). bits 0-5 - Specify which bit of l_addr maps to column address bit 0 bits 6-11 - Specifies which bit of l_addr maps to column address bit 1 ... bits 6*x-6*x+5 - Specifies which bit of l_addr maps to column address bit x Note: When 6'd00 is used, it means a hard-coded zero (not l_addr[0]) except in the case where zero is used in the lower 3 coladdr selections, in which case it refers to l_addr[0].
0x2800 CFG_VRCG_ENABLE reset 0x140
  [9:0] CFG_VRCG_ENABLE — LPDDR4 Vref high current mode enable time tVRCG_ENABLE, expressed in terms of memory clocks.
0x2804 CFG_VRCG_DISABLE reset 0xA0
  [9:0] CFG_VRCG_DISABLE — LPDDR4 Vref high current mode disable time tVRCG_DISABLE, expressed in terms of memory clocks.
0x2808 CFG_WRITE_LATENCY_SET
  [0] CFG_WRITE_LATENCY_SET — LPDDR4 Write Latency Set A/B selection (MR2[6]).
0x280C CFG_THERMAL_OFFSET
  [1:0] CFG_THERMAL_OFFSET — LPDDR4 Thermal Offset (MR4[6:5]).
0x2810 CFG_SOC_ODT
  [2:0] CFG_SOC_ODT — LPDDR4 SOC ODT (MR22[2:0])
0x2814 CFG_ODTE_CK
  [0] CFG_ODTE_CK — LPDDR4 ODTE-CK (MR22[3])
0x2818 CFG_ODTE_CS
  [0] CFG_ODTE_CS — LPDDR4 ODTE-CS (MR22[4])
0x281C CFG_ODTD_CA
  [0] CFG_ODTD_CA — LPDDR4 ODTD-CA (MR22[5])
0x2820 CFG_LPDDR4_FSP_OP
  [0] CFG_LPDDR4_FSP_OP — User-selection for the operating frequency setpoint following LPDDR4 DRAM initialization. This value is written to MR13[7] at the end of the automatic initialization sequence. This value should typically be set to 0 to allow the PHY to perform Command Bus Training (CBT) prior to switching to the faster FSP.
0x2824 CFG_GENERATE_REFRESH_ON_SRX reset 0x1
  [0] CFG_GENERATE_REFRESH_ON_SRX — When exiting self-refresh the controller will wait for a refresh to occur before allowing normal memory requests to resume. The controller can either generate the refresh request immediately or it can wait for the refresh timer to generate the refresh request naturally. In typical systems the controller should be programmed to generate the refresh immediately (cfg_generate_refresh_on_srx=1) for low latency following self-refresh exit. In some dual-controller systems it is advantageous to maintain synchronization in refresh requests and the cfg_generate_refresh_on_srx should be disabled (cfg_generate_refresh_on_srx=0) to allow the synchronized refresh timers to maintain refresh request synchronization.
0x2828 CFG_DBI_CL reset 0x16
  [5:0] CFG_DBI_CL — DDR4 SDRAM DBI CAS read latency, specified in clocks. Refer to SDRAM datasheet for list of supported values.
0x282C CFG_NON_DBI_CL reset 0x16
  [5:0] CFG_NON_DBI_CL — DDR4 SDRAM non-DBI CAS read latency, specified in clocks. Refer to SDRAM datasheet for list of supported values.
0x2830 INIT_FORCE_WRITE_DATA_0
  [8:0] INIT_FORCE_WRITE_DATA_0 — Data driven to memory device nibble lanes when init_force_write is asserted and a regular write is not being driven. Each bit corresponds to one nibble of the memory interface and drives all 4 bits of the corresponding nibble. Bit 0 - driven to DQ nibble [3:0] Bit 1 - driven to DQ nibble [7:4] ... Bit n-1 - driven to DQ nibble [n*4+3:n*4]
0x3C00 CFG_WRITE_CRC
  [0] CFG_WRITE_CRC — Enables DDR4 write CRC mode, where controller automatically generates CRC in transfer 8 for x8 and x16 devices. The CRC is transmitted in transfers 8 and 9 in x4 devices.
0x3C04 CFG_MPR_READ_FORMAT
  [1:0] CFG_MPR_READ_FORMAT — Defines read format during DDR4 MPR reads: 0 - Serial 1 - Parallel (only valid for Page 0 MPR reads) 2 - Staggered (only valid for Page 0 MPR reads)
0x3C08 CFG_WR_CMD_LAT_CRC_DM
  [1:0] CFG_WR_CMD_LAT_CRC_DM — DDR4 extra write command latency when CRC and DM are both enabled. This value is programmed into MR3(10:9). Memory devices use this value to determine the write recovery time required after write with auto-precharge command is issued. 0 - 4 clocks (1600 speed bin) 1 - 5 clocks (1866, 2133, 2400 speed bins) 2 - 6 clocks (TBD speed bin) 3 - RFU
0x3C0C CFG_FINE_GRAN_REF_MODE
  [2:0] CFG_FINE_GRAN_REF_MODE — DDR4 fine granularity refresh mode: 0 - Normal (fixed 1x) 1 - Fixed 2x 2 - Fixed 4x 3 - Reserved 4 - Reserved 5 - On the fly 2x (not supported) 6 - On the fly 4x (not supported) 7 - Reserved When using either Fixed 2x or Fixed 4x fine granularity refresh mode, the refresh period specified by cfg_ref_per is divided internally by 2 or 4, respectively, to produce REFRESH commands at the proper interval.
0x3C10 CFG_TEMP_SENSOR_READOUT
  [0] CFG_TEMP_SENSOR_READOUT — Enables DDR4 device temperature sensor
0x3C14 CFG_PER_DRAM_ADDR_EN
  [0] CFG_PER_DRAM_ADDR_EN — Maps to bit 4 of Mode Register 3 during mode register programming. Must be set to 0 for automatic initialization ('init_autoinit_disable' = 0). Typically set to 0 for manual initialization also ('init_autoinit_disable' = 1), even when per-DRAM addressability mode is used. To enable per-DRAM addressability the mode register should be programmed directly using the 'init_mr_*' signaling. This process is described in Section 9.15 of the DDR4 SDRAM Controller User Guide.
0x3C18 CFG_GEARDOWN_MODE
  [0] CFG_GEARDOWN_MODE — DDR4 geardown mode select: 0 - rate geardown mode 1 - rate geardown mode. Controller will switch to rate geardown mode during initialization sequence.
0x3C1C CFG_WR_PREAMBLE
  [0] CFG_WR_PREAMBLE — Write preamble select: 0 - 1 clock write preamble 1 - 2 clock write preamble Note that it may also be necessary to program the PHY for the desired write preamble mode.
0x3C20 CFG_RD_PREAMBLE
  [0] CFG_RD_PREAMBLE — DDR4 read preamble select: 0 - 1 clock read preamble 1 - 2 clock read preamble
0x3C24 CFG_RD_PREAMB_TRN_MODE
  [0] CFG_RD_PREAMB_TRN_MODE — DDR4 read preamble training mode. Must be set to 0 for automatic initialization ('init_autoinit_disable' = 0).
0x3C28 CFG_SR_ABORT
  [0] CFG_SR_ABORT — Self refresh abort mode select, setting the appropriate mode register bit: 0 - Disable self-refresh abort mode 1 - Enable self-refresh abort mode Note: The controller does not perform operations any sooner after self-refresh exit when self-refresh abort mode is enabled.
0x3C2C CFG_CS_TO_CMDADDR_LATENCY
  [2:0] CFG_CS_TO_CMDADDR_LATENCY — DDR4 command/address latency mode setting: 0 - Disable command/address latency mode 1 - 3 clock command address latency 2 - 4 clock command address latency 3 - 5 clock command address latency 4 - 6 clock command address latency 5 - 8 clock command address latency 6 - Reserved 7 - Reserved Note: DDR4 command/address latency must be disabled in RDIMM/LRDIMM applications, as the RCD does not support this mode.
0x3C30 CFG_INT_VREF_MON
  [0] CFG_INT_VREF_MON — DDR4 internal Vref monitor: 0 - Disable Vref monitor 1 - Enable Vref monitor
0x3C34 CFG_TEMP_CTRL_REF_MODE
  [0] CFG_TEMP_CTRL_REF_MODE — Used to control refresh for DDR4 and self-refresh for HBM. For DDR4 temperature controlled refresh mode: 0 - Disable temperature controlled refresh mode 1 - Enable temperature controlled refresh mode For HBM temperature controlled self-refresh mode: 0 - Disable temperature compensated self-refresh mode 1 - Enable temperature compensated self-refresh mode This bit is loaded into bit 2 (TCSR) of Mode register 0.
0x3C38 CFG_TEMP_CTRL_REF_RANGE
  [0] CFG_TEMP_CTRL_REF_RANGE — DDR4 temperature controlled refresh range. Only used when 'cfg_temp_ctrl_ref_mode' is set to 1: 0 - Normal temperature mode. Below 45 degrees Celsius, DDR4 SDRAM may adjust internal refresh period to be longer than tREFI of the normal temperature range by skipping external refresh commands 1 - Extended temperature mode. In this mode it is expected that the cfg_ref_period is set for the extended temperature range tREFI. In the normal temperature range (0C - 85C), the DDR4 SDRAM adjusts its internal refresh period to tREFI of the normal temperature range. Below 45C, the DDR4 SDRAM may further adjust internal refresh period to be longer than tREFI of the normal temperature range.
0x3C3C CFG_MAX_PWR_DOWN_MODE
  [0] CFG_MAX_PWR_DOWN_MODE — Enables DDR4 maximum power savings mode. Must be set to 0 for automatic initialization ('init_autoinit_disable' = 0).
0x3C40 CFG_READ_DBI
  [0] CFG_READ_DBI — Read data bus inversion (DBI): 0 - Read DBI disabled 1 - Read DBI enabled
0x3C44 CFG_WRITE_DBI
  [0] CFG_WRITE_DBI — Write data bus inversion (DBI): 0 - Write DBI disabled 1 - Write DBI enabled
0x3C48 CFG_DATA_MASK reset 0x1
  [0] CFG_DATA_MASK — Write data mask: 0 - Write data mask disabled 1 - Write data mask enabled For GDDR6 this enables the use of the write-with-single-byte-mask (WSM/A) and write-with-double-byte-mask (WDM/A) commands.
0x3C4C CFG_CA_PARITY_PERSIST_ERR
  [0] CFG_CA_PARITY_PERSIST_ERR — Persistent parity error mode. 0 - DRAM stops checking command/address parity until Parity Error Status bit is cleared 1 - DRAM resumes checking command/address parity after the alert_n is deasserted, even if Parity Error Status bit remains high
0x3C50 CFG_RTT_PARK
  [2:0] CFG_RTT_PARK — RTT_PARK termination value 0 - RTT_PARK disable 1 - RZQ/4 2 - RZQ/2 3 - RZQ/6 4 - RZQ/1 5 - RZQ/5 6 - RZQ/3 7 - RZQ/7
0x3C54 CFG_ODT_INBUF_4_PD
  [0] CFG_ODT_INBUF_4_PD — ODT input buffer during power down mode. 0 - ODT input buffer is activated 1 - ODT input buffer is deactivated
0x3C58 CFG_CA_PARITY_ERR_STATUS
  [0] CFG_CA_PARITY_ERR_STATUS — When the controller does a write to MR5 this signal becomes MR5 bit 4 and clears the parity error status in the DDR4 SDRAM. It should always be set to 0 because the DDR4 spec says to only program it to 0.(C/A Parity error status)"
0x3C5C CFG_CRC_ERROR_CLEAR
  [0] CFG_CRC_ERROR_CLEAR — CRC Error clear. Must be set to 0.
0x3C60 CFG_CA_PARITY_LATENCY
  [2:0] CFG_CA_PARITY_LATENCY — Command / Address Parity setting: 0 - Command / Address Parity disabled 1 - 4 clock parity latency (1600, 1866, 2133 speed bins) 2 - 5 clock parity latency (2400 speed bin) 3 - 6 clock parity latency (TBD speed bin) 4 - 8 clock parity latency (TBD speed bin)
0x3C64 CFG_CCD_S
  [2:0] CFG_CCD_S — SDRAM CAS_n-to-CAS_n delay for different bank group (tCCD_S), specified in clocks. For HBM pseudo channel mode memory, this is tracked for each pseudo channel.
0x3C68 CFG_CCD_L
  [3:0] CFG_CCD_L — SDRAM CAS_n-to-CAS_n delay for same bank group (tCCD_L), specified in clocks. For HBM pseudo channel mode memory, this is tracked for each pseudo channel. Note that when issuing back to back read commands within a pseudo channel that are destined to different SID banks (i.e. SID = 0 in one command and SID = 1 in the other command), the second read will be delayed by cfg_ccd_l (to meet the worst case tCCDR read specification). For back to back writes with SID bit changing within a pseudo channel, the second command is only delayed by cfg_ccd_s l_clks from the first write command (meeting the tCCDR write requirements).
0x3C6C CFG_VREFDQ_TRN_ENABLE
  [0] CFG_VREFDQ_TRN_ENABLE — Enables Vref training mode. Must be set to 0 for automatic initialization ('init_autoinit_disable' = 0).
0x3C70 CFG_VREFDQ_TRN_RANGE
  [0] CFG_VREFDQ_TRN_RANGE — VrefDQ training range selection: 0 - VrefDQ Range 1 1 - VrefDQ Range 2
0x3C74 CFG_VREFDQ_TRN_VALUE
  [5:0] CFG_VREFDQ_TRN_VALUE — Vref training value. Not used during automatic initialization ('init_autoinit_disable'=0).
0x3C78 CFG_RRD_S reset 0x3
  [4:0] CFG_RRD_S — SDRAM ACTIVATE-to-ACTIVATE command period for different bank group (tRRD_S), specified in clocks.
0x3C7C CFG_RRD_L reset 0x3
  [4:0] CFG_RRD_L — SDRAM ACTIVATE-to-ACTIVATE command period for same group (tRRD_L), specified in clocks.
0x3C80 CFG_WTR_S reset 0x2
  [3:0] CFG_WTR_S — SDRAM write to read command delay for different bank group (tWTR_S), specified in clocks.
0x3C84 CFG_WTR_L reset 0x2
  [3:0] CFG_WTR_L — SDRAM write to read command delay for same bank group (tWTR_L), specified in clocks.
0x3C88 CFG_WTR_S_CRC_DM reset 0x2
  [3:0] CFG_WTR_S_CRC_DM — SDRAM write to read command delay for different bank group, when both CRC and DM are enabled (tWTR_S_CRC_DM), specified in clocks.
0x3C8C CFG_WTR_L_CRC_DM reset 0x2
  [4:0] CFG_WTR_L_CRC_DM — SDRAM write to read command delay for same bank group, when both CRC and DM are enabled (tWTR_L_CRC_DM), specified in clocks.
0x3C90 CFG_WR_CRC_DM reset 0x4
  [5:0] CFG_WR_CRC_DM — SDRAM write recovery time when both CRC and DM are enabled (tWR_CRC_DM), specified in clocks
0x3C94 CFG_RFC1 reset 0x22
  [9:0] CFG_RFC1 — SDRAM refresh to activate or refresh command period when in 1x fine granularity refresh mode (tRFC1).
0x3C98 CFG_RFC2 reset 0x22
  [9:0] CFG_RFC2 — SDRAM refresh to activate or refresh command period when in 2x fine granularity refresh mode (tRFC2).
0x3C9C CFG_RFC4 reset 0x22
  [9:0] CFG_RFC4 — SDRAM refresh to activate or refresh command period when in 4x fine granularity refresh mode (tRFC4).
0x3CC4 CFG_NIBBLE_DEVICES
  [0] CFG_NIBBLE_DEVICES — Indicates memory configuration is composed of x4 memory devices or x8/x16 devices. CRC data for writes is generated differently for x4 devices then x8/x16 devices.
{0x3CE0+8i} CFG_BIT_MAP_INDEX_CS{i}_0 (i=0..15)
  [31:0] CFG_BIT_MAP_INDEX_CS{i}_0 — Specifies mapping of DQ pins between memory controller and DRAM devices. When DQ pins are swizzled on circuit board or DIMM modules, the memory controller needs to take this into account when computing CRC values. This is typically done to simplify printed circuit board trace routing. Each 4 bit nibble may be swizzled in a different way. A 6 bit index specifies the swizzle mapping for each DQ nibble. The number of nibbles (n) is equal to the total number of DQ pins divided by 4. The index value specifies the swizzle mapping according to the JEDEC JC-45 SPD contents specification. In addition to index values 1-48 defined there, a value of 0 can be used to specify 1-to-1 mapping.
{0x3CE4+8i} CFG_BIT_MAP_INDEX_CS{i}_1 (i=0..15)
  [21:0] CFG_BIT_MAP_INDEX_CS{i}_1 — Specifies mapping of DQ pins between memory controller and DRAM devices. When DQ pins are swizzled on circuit board or DIMM modules, the memory controller needs to take this into account when computing CRC values. This is typically done to simplify printed circuit board trace routing. Each 4 bit nibble may be swizzled in a different way. A 6 bit index specifies the swizzle mapping for each DQ nibble. The number of nibbles (n) is equal to the total number of DQ pins divided by 4. The index value specifies the swizzle mapping according to the JEDEC JC-45 SPD contents specification. In addition to index values 1-48 defined there, a value of 0 can be used to specify 1-to-1 mapping.
0x3D60 CFG_NUM_LOGICAL_RANKS_PER_3DS
  [3:0] CFG_NUM_LOGICAL_RANKS_PER_3DS — Indicates the number of logical ranks for each physical rank of DDR4 3DS devices. 0x0 Not DDR4 3DS devices 0x2 2H Stacked DDR4 devices 0x4 4H Stacked DDR4 devices 0x8 8H Stacked DDR4 devices
0x3D64 CFG_RFC_DLR1 reset 0x48
  [9:0] CFG_RFC_DLR1 — SDRAM refresh to activate or refresh command period between different logical ranks when in 1x fine granularity mode (tRFC_dlr1), specified in clocks. Only used for DDR4 3DS configurations.
0x3D68 CFG_RFC_DLR2 reset 0x2C
  [9:0] CFG_RFC_DLR2 — SDRAM refresh to activate or refresh command period between different logical ranks when in 2x fine granularity mode (tRFC_dlr2), specified in clocks. Only used for DDR4 3DS configurations.
0x3D6C CFG_RFC_DLR4 reset 0x20
  [9:0] CFG_RFC_DLR4 — SDRAM refresh to activate or refresh command period between different logical ranks when in 4x fine granularity mode (tRFC_dlr4), specified in clocks. Only used for DDR4 3DS configurations.
0x3D70 CFG_RRD_DLR reset 0x4
  [3:0] CFG_RRD_DLR — SDRAM ACTIVATE-to-ACTIVATE command period when activate following another activate is to a different 3DS logical rank (tRRD_dlr), specified in clocks. Only used for DDR4 3DS configurations.
0x3D74 CFG_FAW_DLR reset 0x10
  [6:0] CFG_FAW_DLR — Four bank activate period to different logical ranks (tFAW_dlr), specified in clocks. Only used for DDR4 3DS configurations.
0x3D98 CFG_ADVANCE_ACTIVATE_READY
  [3:0] CFG_ADVANCE_ACTIVATE_READY — Number of DFI clocks to advance the assertion of the l_activate_ready. A value of 0 will cause the assertion of the l_activate_ready to occur on the clock cycle that the controller determines that a bank can be activated. Increasing values of cfg_advance_activate_ready will cause l_activate_ready signals to assert earlier. Deassertion of l_activate_ready will always occur 1 clocks after a request is placed into the queue for that bank, regardless of the cfg_advance_activate_ready setting.
0x4000 CTRLR_SOFT_RESET_N
  [0] CTRLR_SOFT_RESET_N — Memory controller soft reset. Controller is in reset when this is set to 0.
0x4008 CFG_LOOKAHEAD_PCH reset 0x1
  [0] CFG_LOOKAHEAD_PCH — Look-ahead precharge enable. When enabled the controller will look ahead into the command queue and perform precharge and auto-precharge operations as early as possible in order to maximize command bus efficiency and reduce latency. It is recommended that this feature be disabled by hard connection of the port to '0' if the targeting the controller to FPGA running high internal timing frequencies. 0 - disable 1 - enable
0x400C CFG_LOOKAHEAD_ACT reset 0x1
  [0] CFG_LOOKAHEAD_ACT — Look-ahead activate enable. When enabled, the controller will look ahead into the command queue and analyze the queued requests and perform activate operations as soon as possible in order to maximize bandwidth efficiency. It is recommended that this feature be disabled by hard connection of the port to '0' if the targeting the controller to FPGA running high internal timing frequencies. 0 - disable 1 - enable
0x4010 INIT_AUTOINIT_DISABLE
  [0] INIT_AUTOINIT_DISABLE — When set to '1', prevents the controller from generating the memory device initialization sequence. The user can then manually generate the initialization sequence using the remaining init_* controls. After the user has completed the initialization sequence, this signal must be set to '0'. This enables the controller to proceed to training and/or normal operation.
0x4014 INIT_FORCE_RESET
  [0] INIT_FORCE_RESET — Forces assertion of reset control signal (sd_reset_n) going to SDRAM.
0x4018 INIT_GEARDOWN_EN
  [0] INIT_GEARDOWN_EN — When set, causes controller to use geardown command timing. Only applies to DDR4, and is ignored for all other memory types.
0x401C INIT_DISABLE_CKE
  [0] INIT_DISABLE_CKE — Forces de-assertion of clock enable signal going to SDRAM.
0x4020 INIT_CS
  [7:0] INIT_CS — Rank selection for mode register programming requests (using init_mr*), precharge-all requests (using init_precharge_all), refresh (using init_refresh), and ZQ calibration requests (using init_zq_cal_req)
0x4024 INIT_PRECHARGE_ALL
  [0] INIT_PRECHARGE_ALL — Issue Precharge-all command to memory devices on the ranks selected by init_cs.
0x4028 INIT_REFRESH
  [0] INIT_REFRESH — Issue Refresh command to memory devices on the ranks selected by init_cs. It is illegal to assert init_refresh when cfg_auto_ref_en is asserted and init_autoinit_disable is deasserted.
0x402C INIT_ZQ_CAL_REQ
  [0] INIT_ZQ_CAL_REQ — User-initiated ZQ calibration request. Causes ZQ calibration to be issued at the next opportunity to the ranks specified by init_cs. The ZQ calibration will be issued to the ranks corresponding to the asserted bits. The function of this signal is similar to 'l_zq_cal_req'. The port is included here for purposes of user control during initialization (perhaps under software control), whereas 'l_zq_cal_req' is intended to be used after initialization by high-speed synchronous user logic. For those memory types that support it (such as DDR4) the type of ZQ calibration that is performed when this signal is asserted (ZQCL or ZQCS) is determined by 'cfg_zq_cal_type'. It is illegal to assert init_zq_cal_req when cfg_auto_zq_cal_en is asserted and init_autoinit_disable is deasserted.
0x4030 INIT_ACK ro
  [0] INIT_ACK rw — Acknowledge for init_refresh, init_precharge_all, init_mr_w_req, init_zq_cal_req, init_zq_cal_start (LPDDR4) and init_nop. Cleared on read.
0x4034 CFG_BL
  [1:0] CFG_BL — SDRAM maximum burst length (encoded). For "full-rate" configurations of the controller operating in DDR2, LPDDR2, LPDDR3 and HBM modes, values are decoded as follows: cfg_bl = 0x0 - 1 local side transfers / burst (2 DDR transfers) cfg_bl = 0x1 - 2 local side transfers / burst (4 DDR transfers) cfg_bl = 0x2 - 4 local side transfers / burst (8 DDR transfers) cfg_bl = 0x3 - 8 local side transfers / burst (16 DDR transfers) For "half-rate" configurations of the controller operating in DDR2, LPDDR2, LPDDR3 and HBM modes, values are decoded as follows: cfg_bl = 0x0 - Invalid cfg_bl = 0x1 - 1 local side transfer / burst (4 DDR transfers) cfg_bl = 0x2 - 2 local side transfers / burst (8 DDR transfers) cfg_bl = 0x3 - 4 local side transfers / burst (16 DDR transfers) For "quarter-rate" configurations of the controller operating in DDR2, LPDDR2, and LPDDR3, values are decoded as follows: cfg_bl = 0x0 - Invalid cfg_bl = 0x1 - Invalid cfg_bl = 0x2 - 2 local side transfers / burst (8 DDR transfers) cfg_bl = 0x3 - 4 local side transfers / burst (16 DDR transfers) For LPDDR2 memory types, only settings of 0x1 and 0x2 are allowed. For DDR2 memory type, only settings of 0x1 and 0x2 are allowed. For LPDDR3 memory type, only setting of 0x2 is allowed. For HBM memory type, only setting of 0x1 is allowed when operating in the half-rate configuration or when using an HBM Pseudo channel device. Settings of 0x0 and 0x1 are allowed when operating at full-rate with an HBM legacy device.
0x4038 CTRLR_INIT
  [0] CTRLR_INIT — Causes the SDRAM Controller Core to re-issue the initialization sequence to SDRAM devices. The initialization will begin when a 0-1 transition is detected on this signal. Note: The SDRAM Controller Core will always issue the initialization sequence (including the startup delay) after reset regardless of the 'ctrlr_init' state. This signal can be tied low if run-time re-initialization is not required.
0x403C CTRLR_INIT_DONE ro
  [0] CTRLR_INIT_DONE — Deasserted when in reset or after ctrlr_init is asserted, then asserts when initialization sequence has completed. If manual initialization is performed (init_autoinit_disable asserted at startup), this signal will not assert until init_autoinit_disable is deasserted by the user, indicating that the manual initialization sequence has completed.
0x4040 CFG_AUTO_REF_EN reset 0x1
  [0] CFG_AUTO_REF_EN — Enables controller initiated refresh cycles at a periodic rate determined by 'cfg_ref_per'. When this is set to '0', the user logic must take control of refresh by using special addressing techniques or by using the 'l_ref_req' input to manually generate refresh cycles. Controller will postpone a refresh if the memory bus is busy at the end of a 'cfg_ref_per' and will initiate the refresh when the memory bus is available. Up to 8 refresh requests can be postponed. If the 'cfg_auto_ref_en' is disabled, any postponed refresh requests will be cleared.
0x4044 CFG_RAS reset 0x1C
  [6:0] CFG_RAS — SDRAM active to precharge (tRAS), specified in clocks.
0x4048 CFG_RCD reset 0xB
  [6:0] CFG_RCD — SDRAM active to read or write delay (tRCD), specified in memory clocks. For HBM2 and GDDR6 memory see cfg_rcd_rd, cfg_rcd_wr.
0x404C CFG_RRD reset 0x5
  [4:0] CFG_RRD — SDRAM active bank A to active bank B (tRRD), specified in clocks. 'cfg_rp' must be greater than or equal to 'cfg_rrd'.
0x4050 CFG_RP reset 0xB
  [5:0] CFG_RP — SDRAM precharge command period (tRP), specified in clocks. 'cfg_rp' must be greater than or equal to 'cfg_rrd'.
0x4054 CFG_RC reset 0x27
  [7:0] CFG_RC — SDRAM active to active / refresh command period (tRC), specified in clocks.
0x4058 CFG_FAW reset 0x18
  [8:0] CFG_FAW — Four bank activate period (tFAW), specified in clocks
0x405C CFG_RFC reset 0x118
  [9:0] CFG_RFC — SDRAM refresh to active / refresh command period (tRFC) specified in clocks.
0x4060 CFG_RTP reset 0x6
  [4:0] CFG_RTP — SDRAM read to precharge delay (tRTP), specified in clocks
0x4064 CFG_WR reset 0xC
  [5:0] CFG_WR — SDRAM write recovery time (tWR), specified in clocks. If the calculated value is not available then the next higher value should be chosen.
0x4068 CFG_WTR reset 0x6
  [4:0] CFG_WTR — SDRAM write to read command delay (tWTR), specified in clocks.
0x4070 CFG_PASR
  [2:0] CFG_PASR — Partial-Array Self Refresh (PASR) setting that written into PASR field of mode register during initialization.
0x4074 CFG_XP reset 0x2
  [4:0] CFG_XP — SDRAM exit power-down mode to first valid command (tXP), specified in clocks.
0x4078 CFG_XSR reset 0x2
  [9:0] CFG_XSR — SDRAM exit SELF REFRESH to next valid command delay (tXSR), specified in clocks.
0x4080 CFG_CL reset 0xB
  [5:0] CFG_CL — SDRAM CAS read latency, specified in clocks. Refer to SDRAM datasheet for list of supported values.
0x4088 CFG_READ_TO_WRITE reset 0x2
  [3:0] CFG_READ_TO_WRITE — Delay between the end of a read DQS postamble to the start of a write preamble, specified in memory clocks. The controller will delay issuing any write command immediately following a read command to achieve the turnaround time specified by this port. If 2 clock write preamble is being used, this value is specified relative to the middle of the 2 clock preamble.
0x408C CFG_WRITE_TO_WRITE reset 0x3
  [3:0] CFG_WRITE_TO_WRITE — Delay between back-to-back writes which address different ranks of memory, specified in memory clocks. Specifically, this value is the minimum number of clocks between the end of the last data phase on the DQ bus of a write to one rank to the beginning of the first data phase on the DQ bus of a write to another rank. If SDRAM ODT is not used, this can be set to 0 since bus turnaround is not required between back-to-back writes which are switching ranks.
0x4090 CFG_READ_TO_READ reset 0x3
  [3:0] CFG_READ_TO_READ — Bus turnaround delay between back-to-back reads which address different ranks of memory. Specifically, this value is the minimum number of memory clocks between the end of the last data phase on the DQ bus of a read to one rank to the beginning of the first data phase on the DQ bus of a read to another rank. A minimum value of 1 is required or else the DQS preamble of a read to a new rank will contend with the DQS postamble of the read from the previous rank.
0x4094 CFG_WRITE_TO_READ reset 0x2
  [4:0] CFG_WRITE_TO_READ — For DDR2, DDR3, DDR4, LPDDR2, LPDDR3, LPDDR4 and HBM memory types, this is the delay between the end of a write DQS postamble to the start of a read preamble when the read and write commands are to different ranks. If 2 clock read preamble is being used (for memory types that support it) this value is specified relative to the middle of the 2 clock preamble. Value is specified in memory clocks. The controller will delay issuing any read command immediately following a write command to achieve the turnaround time specified by this port. When a read follows a write and the read and write commands are to the same rank, the turnaround is specified by cfg_wtr.
0x4098 CFG_READ_TO_WRITE_ODT reset 0x2
  [3:0] CFG_READ_TO_WRITE_ODT — Delay between the end of a read DQS postamble to the start of a write preamble, specified in memory clocks, when the ODT signals need to change as dictated by the settings of cfg_odt_wr_map_csN and cfg_odt_rd_map_csN. The controller will delay issuing any write command immediately following a read command to achieve the turnaround time specified by this port. If 2 clock write preamble is being used, this value is specified relative to the middle of the 2 clock preamble.
0x409C CFG_WRITE_TO_WRITE_ODT reset 0x3
  [3:0] CFG_WRITE_TO_WRITE_ODT — Delay between back-to-back writes which address different ranks of memory, specified in memory clocks, when the ODT signals need to change as dictated by the settings of cfg_odt_wr_map_csN. Specifically, this value is the minimum number of clocks between the end of the last data phase on the DQ bus of a write to one rank to the beginning of the first data phase on the DQ bus of a write to another rank, where the write ODT settings are different between the two ranks. If SDRAM ODT is not used, this can be set to 0 since bus turnaround is not required between back-to-back writes which are switching ranks. Larger values are required to allow ODT to be properly established (as specified by the cfg_odt_wr_map_csN termination matrix) before the write to the new rank begins.
0x40A0 CFG_READ_TO_READ_ODT reset 0x3
  [3:0] CFG_READ_TO_READ_ODT — Bus turnaround delay between back-to-back reads which address different ranks of memory, when the ODT signals need to change as dictated by the settings of cfg_odt_rd_map_csN. Specifically, this value is the minimum number of memory clocks between the end of the last data phase on the DQ bus of a read to one rank to the beginning of the first data phase on the DQ bus of a read to another rank, where the read ODT settings are different between the two ranks. A minimum value of 1 is required or else the DQS preamble of a read to a new rank will contend with the DQS postamble of the read from the previous rank. Larger values are desired when SDRAM ODT is used to allow ODT to be properly established (as specified by the cfg_odt_rd_map_csN termination matrix) before the read to the new rank begins.
0x40A4 CFG_WRITE_TO_READ_ODT reset 0x2
  [4:0] CFG_WRITE_TO_READ_ODT — Delay between the end of a write DQS postamble to the start of a read preamble when the read and write commands are to different ranks and the ODT signals need to change as dictated by the settings of cfg_odt_wr_map_csN and cfg_odt_rd_map_csN. Value is specified in memory clocks. The controller will delay issuing any read command immediately following a write command to achieve the turnaround time specified by this port. When a read follows a write and the read and write commands are to the same rank, the turnaround is specified by cfg_wtr. If 2 clock read preamble is being used, this value is specified relative to the middle of the 2 clock preamble.
0x40A8 CFG_MIN_READ_IDLE
  [2:0] CFG_MIN_READ_IDLE — Minimum number of clocks of idle time on the bus between non-consecutive read commands. If any two reads are not back-to-back, this is the minimum idle time (in clocks) on the data bus between the reads. Values of 0 and 1 cause no minimum bus idle time between non-consecutive reads to be enforced. There is no difference in behavior between the 0 and 1 settings. This setting is useful for interfacing with physical interfaces which require bus idle time to reset in between reads.
0x40AC CFG_MRD reset 0xC
  [6:0] CFG_MRD — SDRAM load mode register command to active or refresh command (tMRD), specified in clocks.
0x40B0 CFG_BT
  [0] CFG_BT — SDRAM burst type written into "read burst type" field of mode register during initialization sequence. 0 - sequential (typical) 1 - interleaved
0x40B4 CFG_DS
  [3:0] CFG_DS — Output driver strength setting programmed into "Output Driver Impedance Control", "Pull-down Drive Strength" or "Driver Strength" field of mode register during initialization sequence. Refer to SDRAM datasheet for mapping to impedance values. Bits 2 and 3 are ignored for DDR4 and GDDR6 devices. Bit 3 ignored for LPDDR4 devices.
0x40B8 CFG_QOFF
  [0] CFG_QOFF — SDRAM output enable function. This signal is written to output buffer mode (Qoff) mode register bit during initialization. Typically set to '0' to enable data and strobe outputs from the SDRAM devices. Can be set to '1' for IDD characterization of read current.
0x40C4 CFG_RTT reset 0x1
  [2:0] CFG_RTT — ODT effective resistance Rtt. On-Die Termination effective resistance setting programmed into "RTT_NOM" field of mode register during initialization sequence. Refer to SDRAM device datasheet for the mapping to impedance values.
0x40C8 CFG_DLL_DISABLE
  [0] CFG_DLL_DISABLE — Memory device DLL disable. Controls programming of "DLL Enable" field of mode register during initialization sequence. 0 - enable DLL 1 - disable DLL
0x40CC CFG_REF_PER reset 0x1860
  [15:0] CFG_REF_PER — Period between refresh commands issued by the controller, specified in clocks. This value is calculated as: cfg_ref_per = required refresh time interval / tCK If cfg_only_srank_cmds is set to 1 and cfg_quad_rank is set to 0, then the internal refresh interval calculated by the controller will be cfg_ref_per divided by the number of ranks in the system (cfg_num_ranks) since each refresh event will only be refreshing one rank. In this case the internal refresh interval is calculated as: refresh interval = cfg_ref_per / cfg_num_ranks With cfg_only_srank_cmds set to 1 and cfg_quad_rank set to 0, the controller supports cfg_num_ranks settings of 1, 2, 3, 4, 6, 8, or 16. If cfg_only_srank_cmds is set to 1 and cfg_quad_rank is set to 1, then the internal refresh interval calculated by the controller will be cfg_ref_per divided by one-half the number of ranks in the system (cfg_num_ranks) since each refresh event will refresh two ranks (due to cfg_quad_rank). In this case the internal refresh interval is calculated as: refresh interval = cfg_ref_per / ( cfg_num_ranks / 2 ) With cfg_only_srank_cmds set to 1 and cfg_quad_rank set to 1, the controller supports cfg_num_ranks settings of 4, 8, or 16.
0x40D0 CFG_STARTUP_DELAY reset 0x27100
  [18:0] CFG_STARTUP_DELAY — Delay after a reset event that the controller waits before initializing the SDRAM, specified in clocks. The NWL controller supports 4 initialization modes: (1) Phy does all of the DRAM initialization (cfg_startup_delay is a don't care and cfg_ctrlr_init_disable is set to 1) and the NWL controller just waits for dfi_init_complete/dfi_training_complete to be asserted before beginning normal operation (generating refresh requests, etc.) (2) Software does all of the DRAM initialization (cfg_startup delay is a don't care and init_autoinit_disable is set to 1) and the NWL controller just waits for dfi_init_complete/dfi_training_complete to be asserted before beginning normal operation (generating refresh requests, etc.) (3) NWL controller does all of the DRAM initialization (cfg_startup_delay != 0 and phy/software initialization modes are not defined) and then waits for dfi_init_complete/dfi_training_complete to be asserted before beginning normal operation (generating refresh requests, etc.) (4) The phy does all of the early CKE/memory reset initialization of the memory (cfg_startup_delay = 0 and phy/software initialization modes are not defined) and the NWL controller waits for dfi_init_complete/dfi_training_complete to be asserted before sequencing out the final mode registers settings and beginning normal operation (generating refresh requests, etc.)
0x40D4 CFG_MEM_COLBITS reset 0xB
  [3:0] CFG_MEM_COLBITS — Number of bits in the column address.
