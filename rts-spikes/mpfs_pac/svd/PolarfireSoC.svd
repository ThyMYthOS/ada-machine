# Polarfire SoC register map
Vendor: Microchip; File version: 1.0
CPU: Microchip PolarFire SoC 1.0, little endian
Registers are 32-bit, read-write, reset 0x0 unless marked. A register's access mark holds for its fields unless they carry their own. Offsets are from the block's base; [hi:lo] are bit positions; lines under a group give offsets from that group; {n}, {i} and the like mark numbered series.

## DDR_CSR_APB (part 3 of 3) — DDR_CSR_APB Controller
Base 0x20082400
0x430C INIT_PDA_NIBBLE_SELECT
  [17:0] INIT_PDA_NIBBLE_SELECT — Selects nibbles for Per-DRAM addressability mode writes initiated using init_pda_mr_w_req. Each bit corresponds to one nibble of the memory interface and drives all 4 bits of the corresponding nibble during the PDA mode register write. If the interface consists of x8 or x16 devices, then it is recommended that both nibbles of each byte are set to the same select value, in case there is a nibble swap on the DIMM or PCB. Note that at the memory interface, devices are selected with a '0' value on DQ, so the values driven on the DQ bus are the invert of the corresponding init_pda_nibble_select bit setting.
0x4310 CFG_DRAM_CLK_DISABLE_IN_SELF_REFRESH
  [0] CFG_DRAM_CLK_DISABLE_IN_SELF_REFRESH — When set, all clock outputs to DRAM are disabled after all ranks are put into self-refresh. Clocks are automatically restarted before ranks exit self-refresh. Clocks are controlled using the dfi_dram_clk_disable port going to the PHY. It is expected that the DB in an LRDIMM application will need to be retrained after the clocks have been stopped. Therefore this feature is not used in an LRDIMM configuration. The init_dfi_dram_clk_disable port may be used to stop the DRAM clocks for an LRDIMM.
0x4314 CFG_CKSRE reset 0x8
  [4:0] CFG_CKSRE — Valid DRAM clock requirement after self-refresh entry (tCKSRE), specified in memory clocks. For DDR4 the controller automatically includes parity latency so that tCKSRE_PAR is satisfied as well.
0x4318 CFG_CKSRX reset 0x8
  [4:0] CFG_CKSRX — Valid DRAM clock requirement before self-refresh exit (tCKSRX), specified in memory clocks.
0x431C CFG_RCD_STAB
  [13:0] CFG_RCD_STAB — Value for RDIMM RCD clock stabilization time (tSTAB), specified in memory clocks. When clocks are disabled using cfg_dram_clk_disable_in_self_refresh, this delay is combined with cfg_cksrx when the clocks are restarted before the CKE inputs to the RCD are asserted.
0x4320 CFG_DFI_T_CTRL_DELAY
  [7:0] CFG_DFI_T_CTRL_DELAY — Number of memory clocks required for the DFI control signals presented to the PHY to reach the DRAM interface of the PHY. This value is used to delay the disable of the clock going to memory via dfi_dram_clk_disable, after self-refresh entry when cfg_dram_clk_disable_in_self_refresh is set to 1.
0x4324 CFG_DFI_T_DRAM_CLK_ENABLE
  [7:0] CFG_DFI_T_DRAM_CLK_ENABLE — Number of memory clock cycles from the deassertion of the dfi_dram_clk_disable signal until the first valid rising clock edge at the DRAM interface of the PHY.
0x4328 CFG_IDLE_TIME_TO_SELF_REFRESH
  [31:0] CFG_IDLE_TIME_TO_SELF_REFRESH — Duration from the last data transaction to when the controller automatically puts all ranks in self-refresh, specified in memory clocks. A value of 0 disables the automatic self-refresh entry feature.
0x432C CFG_IDLE_TIME_TO_POWER_DOWN
  [31:0] CFG_IDLE_TIME_TO_POWER_DOWN — Duration from the last data transaction to when the controller automatically puts all ranks in power-down, specified in memory clocks. A value of 0 disables the automatic power-down entry feature.
0x4330 CFG_BURST_RW_REFRESH_HOLDOFF
  [0] CFG_BURST_RW_REFRESH_HOLDOFF — When set, refresh request is held off until all writes or reads of current burst has been executed. In this mode, refresh is demoted to priority level below that of writes and reads.
0x4334 INIT_REFRESH_COUNT ro
  [5:0] INIT_REFRESH_COUNT — Indicates the number of REFRESH commands that are in the automatic refresh queue when cfg_auto_ref_en = 1. Values > 1 indicate that REFRESH commands are being postponed.
0x4384 CFG_BG_INTERLEAVE reset 0x1
  [0] CFG_BG_INTERLEAVE — Enables interleaving of bank-groups in back-to-back transactions to avoid tCCD_L delays in DRAM architectures with bank groups (DDR4 and HBM). When set, the address is mapped such that the BG0 bit toggles on each successive read/write command as l_addr is sequentially increased. The Multi-burst core also uses this register to determine when to issue requests with the auto-precharge attribute. When this register is set and l_auto_pch is set for a request, the multiburst module sets the auto-precharge attribute with the last two requests in a multi-burst series so that both of the accessed banks are closed. When this register is clear and l_auto_pch is set, the multiburst module sets the auto-precharge attribute with only the last request since that is the only bank group that has been accessed.
0x43FC CFG_REFRESH_DURING_PHY_TRAINING
  [0] CFG_REFRESH_DURING_PHY_TRAINING — Use in conjunction with cfg_auto_ref_en to enable controller-initiated refresh cycles during PHY training. When this is set to '0', the controller will not issue refresh while PHY training is active.
0x4400 MT_EN
  [0] MT_EN — Rising edge on 'mt_en' or 'mt_enable_single" starts a test.
0x4404 MT_EN_SINGLE
  [0] MT_EN_SINGLE — Enables single memory test. The memory test will only start after a low to high transition of this signal. The memory test will not repeat if 'mt_en_single' remains asserted at the end of the memory test.
0x4408 MT_STOP_ON_ERROR
  [0] MT_STOP_ON_ERROR — When mt_en is held asserted so that the memory test repeats multiple times, setting this bit will prevent the test from repeating again if an error was detected on the previous run. This is useful for debugging very infrequent errors which require many repetitions of the test before the error occurs. For example, once the error has occurred and the test has stopped, the test can be repeated with the 'mt_read_only' flag set, to help determine if the error occurred on a write or a read.
0x440C MT_RD_ONLY
  [0] MT_RD_ONLY — Causes only reads to be performed when the memory test is enabled. Should not be set when 'mt_wr_only' is also set.
0x4410 MT_WR_ONLY
  [0] MT_WR_ONLY — Causes only writes to be performed when the memory test is enabled. Should not be set when 'mt_rd_only' is also set.
0x4414 MT_DATA_PATTERN
  [3:0] MT_DATA_PATTERN — Memory test data pattern selection: 0x0 : Counting pattern 0x1 : Walking 1's 0x2 : Repeating Pseudo-random data (generated with LFSR). Repeats pattern sequence on each pass when test is run repetitively with 'mt_en' held high. 0x3 : Non-Repeating Pseudo-random data (generated with LFSR). Pattern continues from where it left off on previous test when 'mt_en' is held high. 0x4 : Alternating all 1's and all 0's 0x5 : Alternating 5's and a's 0x6 : User-specified pattern, specified with mt_user_data_pattern. Pattern copied across all bytes of data bus on memory writes, and all bytes of expected data on memory reads. 0x7 : Pseudo-random 16-bit data (generated with LFSR), copied across all words of data bus. 0x8 : Pseudo-random 8-bit data (generated with LFSR), copied across all bytes of data bus.
0x4418 MT_ADDR_PATTERN
  [1:0] MT_ADDR_PATTERN — Memory test address pattern selection: 0x0 : Counting pattern 0x1 : LFSR 0x2 : Arbitrary Pattern Generator 0x3 : Reserved The LFSR address pattern is used only when the LFSR address pattern is selected and (mt_addr_bits - cfg_bl - 1) is greater than 2. Otherwise, counting address pattern is used, regardless of which address pattern is selected.
0x441C MT_DATA_INVERT
  [0] MT_DATA_INVERT — Invert data pattern
0x4420 MT_ADDR_BITS reset 0x8
  [5:0] MT_ADDR_BITS — Address range to test. Test will start at 'mt_start_addr' and continue to addresses 'mt_start_addr' + 2 ^ mt_addr_bits. Note: The minimum valid value is a function of memory burst length: 1 - (memory burst length = 2) 2 - (memory burst length = 4) 3 - (memory burst length = 8)
0x4424 MT_ERROR_STS ro
  [0] MT_ERROR_STS rw — Goes true when the memory test module detects a mismatch between expected data and the data read from the sdram. Cleared immediately after reading this csr.
0x4428 MT_DONE_ACK ro
  [0] MT_DONE_ACK rw — Indicates completion of memory test through address range specified by 'mt_addr_bits'. Signal is asserted when final test completes after mt_en has been cleared.
0x44B4 MT_START_ADDR_0
  [31:0] MT_START_ADDR_0 — Address to start memory test at. This port is not used when 'mt_addr_pattern' is set to 0x1 (pseudo-random).
0x44B8 MT_START_ADDR_1
  [6:0] MT_START_ADDR_1 — Address to start memory test at. This port is not used when 'mt_addr_pattern' is set to 0x1 (pseudo-random).
{0x44BC+4i} MT_ERROR_MASK_{i} (i=0..3)
  [31:0] MT_ERROR_MASK_{i} — Error mask. All bits set in this field will mask read-back errors in corresponding data bits. The 'mt_error_sts' flag will not get set when errors are encountered on those data bits.
0x44CC MT_ERROR_MASK_4
  [15:0] MT_ERROR_MASK_4 — Error mask. All bits set in this field will mask read-back errors in corresponding data bits. The 'mt_error_sts' flag will not get set when errors are encountered on those data bits.
0x4670 MT_USER_DATA_PATTERN
  [7:0] MT_USER_DATA_PATTERN — User-specified data pattern for use with Algorithmic Pattern Generator, when mt_data_pattern selects user-specified pattern.
0x467C MT_ALG_AUTO_PCH
  [0] MT_ALG_AUTO_PCH — Causes auto_precharge to be asserted when the memory test is enabled and the algorithmic pattern generator is being used.
{0x4C00+4i} CFG_STARVE_TIMEOUT_P{i} (i=0..7)
  [11:0] CFG_STARVE_TIMEOUT_P{i} — Amount of time that may elapse (in system clocks) before this port is serviced. If a request is pending to this port for a period of time longer than 'cfg_starve_timeout_pN', it will automatically be promoted to the highest priority and serviced next. Any port having this value set to '0' will have its starvation timeout disabled.
0x5000 CFG_REORDER_EN reset 0x1
  [0] CFG_REORDER_EN — Enable for request reordering. 0 - Request reordering disabled 1 - Request reordering enabled This port is only used in configurations of the Reorder Core where request reordering is supported. Refer to section 3.4 for details on request reordering. When this port is set to '1' and 'cfg_reorder_queue_en' is also '1', reordering of buffered entries is enabled, otherwise the buffered entries are issued in fifo order. If 'cfg_reorder_queue_en' is set to '0', cfg_reorder_en is a don't care.
0x5004 CFG_REORDER_QUEUE_EN reset 0x1
  [0] CFG_REORDER_QUEUE_EN — Reorder queue enable. When set to '1', allows requests to stack up in reorder queue. Reordering will occur if 'cfg_reorder_en' is also set to 1. This port is only used in configurations of the Reorder Core where request reordering is supported. Refer to section section 3.4 for details on request reordering. This port is typically only provided for ASIC configurations. Under normal circumstances this port will always be set to '1'. It is provided for debugging purposes.
0x5008 CFG_INTRAPORT_REORDER_EN reset 0x1
  [0] CFG_INTRAPORT_REORDER_EN — Enable intra-port reordering. 0 - Intra-port request reordering disabled 1 - Intra-port request reordering enabled This port is ignored if cfg_reorder_en is set to '0'. Refer to section section 3.4 for details on request reordering and intraport reordering.
0x500C CFG_MAINTAIN_COHERENCY reset 0x1
  [0] CFG_MAINTAIN_COHERENCY — Causes data coherency to be maintained by preventing reordering of requests addressing the same memory region. Refer to Reorder Core User Guide for a description of memory regions.
0x5010 CFG_Q_AGE_LIMIT reset 0xFF
  [7:0] CFG_Q_AGE_LIMIT — Reorder core queue entry age limit. The age limit value prevents the oldest entry in the queue from being 'stuck' in the reorder queue for too long. When the oldest entry in the queue changes, the age limit counter is reset and starts counting. Each time a newer entry exits the reorder queue (has been issued to the controller) without the oldest entry in the queue being issued, the 'age' of the oldest entry in the queue is incremented. If cfg_q_age_limit newer entries are issued before the oldest entry is issued, then the oldest entry in the queue becomes the highest priority and is always issued next. The width of the cfg_q_age_limit value is set by the parameter QUEUE_AGE_BITS. QUEUE_AGE_BITS can be set to as small as 1 (but this is not recommended) and can be set to as large of a value that the application needs; however when using cfg_q_age_limit values larger than the REORDER_QUEUE_DEPTH, this can result in the oldest entry being "stuck" in the queue for too long. This port is only useful in configurations of the Reorder Core where request reordering is supported. Refer to section 3.4 for details on request reordering. Both 'cfg_reorder_en' and 'cfg_reorder_queue_en' must be set to '1'. When either of these configuration bits are set to 0, the reorder queue entries are issued in the order that they arrived at the input to the reorder queue.
0x5018 CFG_RO_CLOSED_PAGE_POLICY
  [0] CFG_RO_CLOSED_PAGE_POLICY — Reorder core closed page policy control. When this bit is set, the reorder core adjusts its reordering algorithm (currently only when using Criteria 0) to optimize for the case that all read/write accesses are issued with the auto_precharge bit set. When the reorder_queue entry buffering is enabled (cfg_reorder_queue_en = 1), this bit forces all accesses that exit the reorder core to have the auto-precharge bit set if the closed page policy mode has been selected. In other words, cfg_ro_closed_page_policy must be clear or cfg_reorder_queue_en must be clear to allow l_auto_pch inputs (per port) to control the auto precharge function per mpfe input port.
0x501C CFG_REORDER_RW_ONLY
  [0] CFG_REORDER_RW_ONLY — Reorder core read/write reordering only. When this bit is set, the reorder core adjusts its reordering algorithm (currently only when using Criteria 0)to maximize the grouping of reads and writes together (normal Criteria 0 filtering is not used). Switching between issuing reads and writes only occur if one of the following things occur: o Issuing a stream of reads (or writes) and there are no more coherent, priority-enabled reads (or writes) to issue o The oldest entry in the reorder queue times out. Note that if cfg_manual_address_map is set and reordering is enabled, then the cfg_reorder_rw_only bit should normally be set as well (normal reordering algorithms will not work as expected if using manual address mapping in the controller core). When cfg_reorder_rw_only is clear and reordering is enabled, then the normal filtering algorithm is used to select the next request to issue from the reorder core.
0x5020 CFG_RO_PRIORITY_EN
  [0] CFG_RO_PRIORITY_EN — Reorder_core QOS/priority enable. When this bit is set (and REORDER_PRIORITY_ENABLE paramter was set during synthesis), the reorder core will normally send out only requests that have the highest priority (except if the oldest entry in the reorder core has aged/timed-out). If clear (or the REORDER_PRIORITY_ENABLE parameter was clear during synthesis), the reorder core ignores any incoming priority and selects the next request from the reorder_queue to maximize bandwidth/performance.
0x5400 CFG_DM_EN reset 0x1
  [0] CFG_DM_EN — When set to '1' the RMW Core will use data mask signals to the memory in order to optimize certain RMW operations. This port must be set to '0' if the DRAM data mask signals are not connected to the memory devices.
0x5404 CFG_RMW_EN reset 0x1
  [0] CFG_RMW_EN — Enable or disable RMW. 0 - disables RMW operations. 1 - enables RMW operations. When disabled, the RMW Core requires that the memory support data mask functionality (no ECC, data mask pins connected through to memory devices) and cfg_dm_en must be set to '1'. A setting of '0' also enables use of the 'l_dm_in' data mask inputs.
0x5800 CFG_ECC_CORRECTION_EN reset 0x1
  [0] CFG_ECC_CORRECTION_EN — Enables ECC error correction and detection 0x1 - Correction and detection function is enabled, 1 bit errors will be corrected, multi-bit errors will not be corrected. Errors occurring in an odd number of bits (3,5,7, etc.) could have additional bit inversions due to attempted correction. 0x0 - Correction and detection function is disabled. ECC errors are not reported.
0x5840 CFG_ECC_BYPASS
  [0] CFG_ECC_BYPASS — When set to 1, the controller will not compute ECC check data or perform ECC correction on received data. When in ECC bypass mode, axiN_wdata_parity input pins are repurposed to be the data that gets written to ECC memory. Likewise, axiN_rdata_parity outputs are repurposed to be the data that gets read out of ECC memory.
0x5844 INIT_WRITE_DATA_1B_ECC_ERROR_GEN
  [1:0] INIT_WRITE_DATA_1B_ECC_ERROR_GEN — Memory controller write data path 1-bit ECC error generation. This register contains one bit per 64-bits (ECC generators are used per 64-bits of data path width) of user interface data path width. When set, will invert the corresponding ECC generator's least significant ECC check bit (causing a 1-bit ECC error) on the next cycle of write data. Error generation will persist for only one cycle. To cause a subsequent 1-bit ECC error generation cycle, a bit must be written to 0 and then back to 1.
0x5848 INIT_WRITE_DATA_2B_ECC_ERROR_GEN
  [1:0] INIT_WRITE_DATA_2B_ECC_ERROR_GEN — Memory controller write data path 2-bit ECC error generation. This register contains one bit per 64-bits (ECC generators are used per 64-bits of data path width) of user interface data path width. When set, will invert the corresponding ECC generator's 2 most significant of the 3 least significant ECC check bits (causing a 2-bit ECC error) on the next cycle of write data. Error generation will persist for only one cycle. To cause a subsequent 2-bit ECC error generation cycle, a bit must be written to 0 and then back to 1.
0x585C CFG_ECC_1BIT_INT_THRESH
  [7:0] CFG_ECC_1BIT_INT_THRESH — This 8-bit value defines the number of ECC 1-bit error corrections that must be exceeded before the stat_int_ecc_1bit_thresh status bit (and interrupt output pin) are set and the error summing register is cleared to start summing new ECC 1bit error correction counts. Setting this value to 0 means that each new correctable ecc error will signal an interrupt/set the status bit. Setting this value to the maximum value of 0xff will disable generating the interrupt and interrupt status. Note that if the parity error retry module is included, 1bit error corrections signaled into that unit are not counted and only the 1bit corrected errors that are passed on to the user logic interface from this unit are counted. Also if the RMW unit is included and a read prefetch is performed to allow data to be merged with a user write and the read prefetch results in a 1bit ecc correction, this 1bit correction will be counted by the ecc_1bit_int_threshold detection logic. Finally, if the ECC Scrub logic is included, any ECC corrections deteted by this unit will also be counted.
0x5860 STAT_INT_ECC_1BIT_THRESH ro
  [0] STAT_INT_ECC_1BIT_THRESH rw — This bit is set when the number of 1bit ECC error corrections is greater-than the cfg_ecc_1bit_thresh. This status bit should be read to clear the status and associated interrupt pin output as soon as possible, to avoid missing the setting of this status/interrupt due to new 1bit ECC error corrections.
0x5C00 INIT_READ_CAPTURE_ADDR
  [3:0] INIT_READ_CAPTURE_ADDR — Address to be read from read capture buffer. The address is referenced to the location of the buffer corresponding to the oldest data captured (i.e. location 0 is the oldest captured data). A write to this register will strobe the init_read_capture_data 'holding register' with new data from the specified address. The first subsequent read to init_read_capture_data will get this data from the 'holding register'; thus an update of init_read_capture_addr should only occur after the read data has been captured in the controller and the controller is quiesced (not performing new local bus or csr initiated reads). The read capture buffer has a depth based on the frequency ratio and the supported memory type. For memory controller configurations that support LPDDR4 memory, the depth is as follows: Frequency ratio 1 - depth is 8 entries Frequency ratio 2 - depth is 4 entries Frequency ratio 4 - depth is 2 entries For all other memory controller configurations, the depth is as follows: Frequency ratio 1 - depth is 4 entries Frequency ratio 2 - depth is 2 entries Frequency ratio 4 - depth is 1 entry
{0x5C04+4i} INIT_READ_CAPTURE_DATA_{i} ro (i=0..3)
  [31:0] INIT_READ_CAPTURE_DATA_{i} — A read returns data from read capture buffer holding register that must first be set to the new value at an offset set by a write to the 'init_read_capture_addr'. Each read of the 'init_read_capture_data' register will automatically increment the read address after the read to the next location of the buffer and update the read capture buffer holding register with the new data to allow efficiently reading the locations sequentially. Note that the user must not initiate any new memory device reads that will update read capture buffer, until the init_read_caputre buffer has been read-out for the prior memory device read.
0x5C14 INIT_READ_CAPTURE_DATA_4 ro
  [15:0] INIT_READ_CAPTURE_DATA_4 — A read returns data from read capture buffer holding register that must first be set to the new value at an offset set by a write to the 'init_read_capture_addr'. Each read of the 'init_read_capture_data' register will automatically increment the read address after the read to the next location of the buffer and update the read capture buffer holding register with the new data to allow efficiently reading the locations sequentially. Note that the user must not initiate any new memory device reads that will update read capture buffer, until the init_read_caputre buffer has been read-out for the prior memory device read.
0x6400 CFG_ERROR_GROUP_SEL
  [0] CFG_ERROR_GROUP_SEL — Specify compressed error bus or actual data bytes for storage. Refer to Memory Test Analyzer Core User Guide. 0 - Actual bytes/byte lanes are stored 1 - Compressed error bus stored.
0x6404 CFG_DATA_SEL
  [6:0] CFG_DATA_SEL — Select byte lane or compressed error bus for storage. Refer to the Memory Test Analyzer Core User Guide.
0x6408 CFG_TRIG_MODE
  [0] CFG_TRIG_MODE — Used by the Memory Test Analyzer Core and Data Analyzer Core. Refer to the respective core User Guides for details. If 1: Acquisition acquires continuously on acq_en, stopping after the trigger by cfg_acq_cycs_post_trig. If 0: Acquisition acquires without trigger on acq_en
0x640C CFG_POST_TRIG_CYCS
  [6:0] CFG_POST_TRIG_CYCS — Defines the number of acq_en qualified cycles to store after the trigger (including the trigger cycle)
0x6410 CFG_TRIG_MASK
  [2:0] CFG_TRIG_MASK — Bits of AND trigger bus to mask (address match, error, valid = [2:0]). Refer to the Memory Test Analyzer Core User Guide. Trigger on: 3'b000 - valid cycles where error occurs on an address match 3'b010 - valid cycles with an address match 3'b100 - valid cycles with an error 3'b110 - valid cycles All other bit combinations reserved.
0x6414 CFG_EN_MASK
  [1:0] CFG_EN_MASK — Bits of AND enable bus to mask (error, valid = [1:0]). Refer to the Memory Test Analyzer Core User Guide. Store data in Acquisition Memory on: 2'b00 - Valid cycles containing errors 2'b10 - Valid cycles All other bit combinations reserved.
0x6418 MTC_ACQ_ADDR
  [5:0] MTC_ACQ_ADDR — Address to initialize Capture Memory Address (with 'acq_addr_wr_en')
0x641C MTC_ACQ_CYCS_STORED ro
  [6:0] MTC_ACQ_CYCS_STORED — Number of vectors stored with last armed acquisition. Note: This value is not synchonized for CSR readout with coherency of the bits. It is assumed that this register is only read when the memory test is idle.
0x6420 MTC_ACQ_TRIG_DETECT ro
  [0] MTC_ACQ_TRIG_DETECT — Indicates if trigger was detected in last armed acquisition
0x6424 MTC_ACQ_MEM_TRIG_ADDR ro
  [5:0] MTC_ACQ_MEM_TRIG_ADDR — Memory address corresponding to trigger vector. Note: This value is not synchonized for CSR readout with coherency of the bits. It is assumed that this register is only read when the memory test is idle.
0x6428 MTC_ACQ_MEM_LAST_ADDR ro
  [5:0] MTC_ACQ_MEM_LAST_ADDR — Memory address of last stored vector. Note: This value is not synchonized for CSR readout with coherency of the bits. It is assumed that this register is only read when the memory test is idle.
0x642C MTC_ACK ro
  [0] MTC_ACK rw — Set to acknowledge completion of read or write of acquisition memory, or to write of acquisition memory address in Memory Test Analyzer Core.
0x6430 CFG_TRIG_MT_ADDR_0
  [31:0] CFG_TRIG_MT_ADDR_0 — Specify match address for triggered address mode
0x6434 CFG_TRIG_MT_ADDR_1
  [6:0] CFG_TRIG_MT_ADDR_1 — Specify match address for triggered address mode
{0x6438+4i} CFG_TRIG_ERR_MASK_{i} (i=0..3)
  [31:0] CFG_TRIG_ERR_MASK_{i} — Per-bit mask for memory errors (affect trigger, enable, and error acquisition)
0x6448 CFG_TRIG_ERR_MASK_4
  [15:0] CFG_TRIG_ERR_MASK_4 — Per-bit mask for memory errors (affect trigger, enable, and error acquisition)
0x644C MTC_ACQ_WR_DATA_0
  [31:0] MTC_ACQ_WR_DATA_0 — Write Data for Capture Memory Debug
0x6450 MTC_ACQ_WR_DATA_1
  [31:0] MTC_ACQ_WR_DATA_1 — Write Data for Capture Memory Debug
0x6454 MTC_ACQ_WR_DATA_2
  [7:0] MTC_ACQ_WR_DATA_2 — Write Data for Capture Memory Debug
0x6458 MTC_ACQ_RD_DATA_0 ro
  [31:0] MTC_ACQ_RD_DATA_0 — Read Data for Capture Memory Read back
0x645C MTC_ACQ_RD_DATA_1 ro
  [31:0] MTC_ACQ_RD_DATA_1 — Read Data for Capture Memory Read back
0x6460 MTC_ACQ_RD_DATA_2 ro
  [7:0] MTC_ACQ_RD_DATA_2 — Read Data for Capture Memory Read back
0x652C CFG_PRE_TRIG_CYCS
  [15:0] CFG_PRE_TRIG_CYCS — Defines the number of acq_en qualified cycles to skip before enabling storage for subsequent cycles.
0x6538 MTC_ACQ_ERROR_CNT ro
  [9:0] MTC_ACQ_ERROR_CNT — Number of errors detected in the current acquisition.
0x6544 MTC_ACQ_ERROR_CNT_OVFL ro
  [0] MTC_ACQ_ERROR_CNT_OVFL — The mtc_acq_error_cnt counter has overflowed.
0x6550 CFG_DATA_SEL_FIRST_ERROR
  [0] CFG_DATA_SEL_FIRST_ERROR — Select first byte lane with compressed error bus bit set for storage. Has priority over cfg_data_sel setting. Refer to the Memory Test Analyzer Core User Guide.
0x7C00 CFG_DQ_WIDTH
  [1:0] CFG_DQ_WIDTH — Variable DQ width. 0 - Full-Width 1 - Half-Width 2 - Quarter-Width
0x7C04 CFG_ACTIVE_DQ_SEL
  [1:0] CFG_ACTIVE_DQ_SEL — Selectable active DQ. 0 - Word/Byte 0 1 - Word/Byte 1 2 - Word/Byte 2 3 - Word/Byte 3
0x8000 STAT_CA_PARITY_ERROR ro
  [0] STAT_CA_PARITY_ERROR rw — For DDR4: Asserts when an assertion is detected on the 'ALERT_n' pin. Each occurrence of a write CRC error or CA parity error will cause assertion of the DDR4 device 'ALERT_n' pin. For HBM: Asserts when an assertion is detected on the 'AERR' pin. Each occurrence of an address parity error will cause an assertion of the HBM device 'AERR' pin. The value is cleared on read.
0x800C INIT_CA_PARITY_ERROR_GEN_REQ
  [0] INIT_CA_PARITY_ERROR_GEN_REQ — When asserted, causes parity error to be introduced on command/address bus on the next command corresponding to that specified in the init_ca_parity_error_gen_cmd register. The parity error is generated by inverting the 'parity_in' bit going to the PHY from the calculated even parity value. Only one parity error is introduced per 'init_ca_parity_error_gen_req' / 'init_ca_parity_error_gen_ack' cycle.
0x8010 INIT_CA_PARITY_ERROR_GEN_CMD
  [3:0] INIT_CA_PARITY_ERROR_GEN_CMD — Specifies command for which parity error will be generated when 'init_ca_parity_error_gen_req' is asserted. The controller will wait for this command before generating the error. Command encoding is as follows: 0x0 - Reserved 0x1 - Reserved 0x2 - Reserved 0x3 - Reserved 0x4 - Reserved 0x5 - Reserved 0x6 - Reserved 0x7 - ACT 0x8 - MRS 0x9 - REF 0xa - PRE / PREA 0xb - Reserved 0xc - WR/WRA 0xd - RD/RDA 0xe - ZQ-Cal 0xf - NOP
0x8014 INIT_CA_PARITY_ERROR_GEN_ACK ro
  [0] INIT_CA_PARITY_ERROR_GEN_ACK rw — Asserted to acknowledge 'init_ca_parity_error_gen_req'.
0x10000 CFG_DFI_T_RDDATA_EN reset 0x14
  [5:0] CFG_DFI_T_RDDATA_EN — Used to derive the delay from assertion of read command to dfi_rddata_en assertion at the DFI interface. The resulting delay, referred to as tRDDATA_EN in the DFI specification, is calculated below. Full-Rate: CAS read latency + Additive Latency + Parity Latency (DDR4 only) + Command Address Latency (DDR4 only) + cfg_regdimm + cfg_dfi_t_rddata_en - 9 Half-Rate: CAS read latency + Additive Latency + Parity Latency (DDR4 only) + Command Address Latency (DDR4 only) + cfg_regdimm + cfg_dfi_t_rddata_en - 19 Quarter-Rate: CAS read latency + Additive Latency + Parity Latency (DDR4 only) + Command Address Latency (DDR4 only) + cfg_regdimm + cfg_dfi_t_rddata_en - 36 This value is typically established as a constant for a particular PHY and is not intended to be changed from its reset value. Since the tRDDATA_EN that the controller generates is a function of the programmed latencies, cfg_dfi_t_rddata_en does not need to be reprogrammed whenever the latencies are changed.
0x10004 CFG_DFI_T_PHY_RDLAT reset 0x5
  [4:0] CFG_DFI_T_PHY_RDLAT — Number of memory clocks from assertion of dfi_rddata_en to dfi_rddata_valid assertion. This parameter is only valid for PHY configurations where the dfi_rddata_valid is generated within the controller and the dfi_rddata_valid from the PHY is unused or unavailable. When the controller is generating the dfi_rddata_valid, this value is set based on PHY requirements.
0x10008 CFG_DFI_T_PHY_WRLAT reset 0x5
  [5:0] CFG_DFI_T_PHY_WRLAT — Used to derive the delay from assertion of the write command to dfi_wrdata_en assertion at the DFI interface. The resulting delay, referred to as tPHY_WRLAT in the DFI specification, is calculated below. Full-Rate: CAS write latency + Additive Latency + Parity Latency (DDR4 only) + Command Address Latency (DDR4 only) + cfg_regdimm + cfg_dfi_t_phy_wrlat - 3 Half-Rate: CAS write latency + Additive Latency + Parity Latency (DDR4 only) + Command Address Latency (DDR4 only) + cfg_regdimm + cfg_dfi_t_phy_wrlat - 6 Quarter-Rate: CAS write latency + Additive Latency + Parity Latency (DDR4 only) + Command Address Latency (DDR4 only) + cfg_regdimm + cfg_dfi_t_phy_wrlat - 12 This value is typically established as a constant for a particular PHY and is not intended to be changed from its reset value. Since the tPHY_WRLAT that the controller generates is a function of the programmed latencies, cfg_dfi_phy_wrlat does not need to be reprogrammed whenever the latencies are changed.
0x1000C CFG_DFI_PHYUPD_EN reset 0x1
  [0] CFG_DFI_PHYUPD_EN — For PHYs using dfi_phyupd_req, this register can configure the PHY not to assert requests during initialization or test sequences where the update requests could cause interference with the controller.
0x10010 INIT_DFI_LP_DATA_REQ
  [0] INIT_DFI_LP_DATA_REQ — Value applied to dfi_lp_data_req on DFI interface to PHY.
0x10014 INIT_DFI_LP_CTRL_REQ
  [0] INIT_DFI_LP_CTRL_REQ — Value applied to dfi_lp_ctrl_req on DFI interface to PHY.
0x10018 STAT_DFI_LP_ACK ro
  [0] STAT_DFI_LP_ACK rw — Status of dfi_lp_ack on DFI interface from PHY.
0x1001C INIT_DFI_LP_WAKEUP
  [3:0] INIT_DFI_LP_WAKEUP — Value applied to dfi_lp_wakeup on DFI interface to PHY.
0x10020 INIT_DFI_DRAM_CLK_DISABLE
  [1:0] INIT_DFI_DRAM_CLK_DISABLE — Value applied to dfi_dram_clk_disable on DFI interface to PHY.
0x10024 STAT_DFI_TRAINING_ERROR ro
  [0] STAT_DFI_TRAINING_ERROR — Status of dfi_training_error on DFI interface from PHY.
0x10028 STAT_DFI_ERROR ro
  [0] STAT_DFI_ERROR rw — Status of dfi_error on DFI interface from PHY.
0x1002C STAT_DFI_ERROR_INFO ro
  [3:0] STAT_DFI_ERROR_INFO — Status of dfi_error_info on DFI interface from PHY.
0x10030 CFG_DFI_DATA_BYTE_DISABLE
  [4:0] CFG_DFI_DATA_BYTE_DISABLE — Value applied to dfi_data_byte_disable on DFI interface to PHY.
0x10034 STAT_DFI_INIT_COMPLETE ro
  [0] STAT_DFI_INIT_COMPLETE — Status of dfi_init_complete on DFI interface from PHY.
0x10038 STAT_DFI_TRAINING_COMPLETE ro
  [0] STAT_DFI_TRAINING_COMPLETE — Status of dfi_training_complete on DFI interface from PHY.
0x1003C CFG_DFI_LVL_SEL
  [0] CFG_DFI_LVL_SEL — Mux select for dfi_lvl_periodic and dfi_lvl_pattern. 0 - PHY initialization module controls signals 1 - CSR control
0x10040 CFG_DFI_LVL_PERIODIC
  [0] CFG_DFI_LVL_PERIODIC — Training length indicator.
0x10044 CFG_DFI_LVL_PATTERN
  [3:0] CFG_DFI_LVL_PATTERN — Training pattern used for read training.
0x10050 PHY_DFI_INIT_START
  [0] PHY_DFI_INIT_START — Set the init start signal into the PHY
0x12C18 CFG_AXI_START_ADDRESS_AXI1_0
  [31:0] CFG_AXI_START_ADDRESS_AXI1_0 — Sets the lower valid AXI address boundary for this AXI Interface. The AXI Interface Core will respond with a DECERR (decode error) response to AXI read and write requests with an address value less than this port setting. The Verilog parameter ADDR_MAP_SIG_BITS sets the number of significant bits that are used in the address value comparison.
0x12C1C CFG_AXI_START_ADDRESS_AXI1_1
  [1:0] CFG_AXI_START_ADDRESS_AXI1_1 — Sets the lower valid AXI address boundary for this AXI Interface. The AXI Interface Core will respond with a DECERR (decode error) response to AXI read and write requests with an address value less than this port setting. The Verilog parameter ADDR_MAP_SIG_BITS sets the number of significant bits that are used in the address value comparison.
0x12C20 CFG_AXI_START_ADDRESS_AXI2_0
  [31:0] CFG_AXI_START_ADDRESS_AXI2_0 — Sets the lower valid AXI address boundary for this AXI Interface. The AXI Interface Core will respond with a DECERR (decode error) response to AXI read and write requests with an address value less than this port setting. The Verilog parameter ADDR_MAP_SIG_BITS sets the number of significant bits that are used in the address value comparison.
0x12C24 CFG_AXI_START_ADDRESS_AXI2_1
  [1:0] CFG_AXI_START_ADDRESS_AXI2_1 — Sets the lower valid AXI address boundary for this AXI Interface. The AXI Interface Core will respond with a DECERR (decode error) response to AXI read and write requests with an address value less than this port setting. The Verilog parameter ADDR_MAP_SIG_BITS sets the number of significant bits that are used in the address value comparison.
0x12F18 CFG_AXI_END_ADDRESS_AXI1_0 reset 0xFFFFFFFF
  [31:0] CFG_AXI_END_ADDRESS_AXI1_0 — Sets the upper valid AXI address boundary for this AXI Interface. The AXI Interface Core will respond with a DECERR (decode error) response to AXI read and write requests with an address value greater than this port setting. The Verilog parameter ADDR_MAP_SIG_BITS sets the number of significant bits that are used in the address value comparison.
0x12F1C CFG_AXI_END_ADDRESS_AXI1_1 reset 0x3
  [1:0] CFG_AXI_END_ADDRESS_AXI1_1 — Sets the upper valid AXI address boundary for this AXI Interface. The AXI Interface Core will respond with a DECERR (decode error) response to AXI read and write requests with an address value greater than this port setting. The Verilog parameter ADDR_MAP_SIG_BITS sets the number of significant bits that are used in the address value comparison.
0x12F20 CFG_AXI_END_ADDRESS_AXI2_0 reset 0xFFFFFFFF
  [31:0] CFG_AXI_END_ADDRESS_AXI2_0 — Sets the upper valid AXI address boundary for this AXI Interface. The AXI Interface Core will respond with a DECERR (decode error) response to AXI read and write requests with an address value greater than this port setting. The Verilog parameter ADDR_MAP_SIG_BITS sets the number of significant bits that are used in the address value comparison.
0x12F24 CFG_AXI_END_ADDRESS_AXI2_1 reset 0x3
  [1:0] CFG_AXI_END_ADDRESS_AXI2_1 — Sets the upper valid AXI address boundary for this AXI Interface. The AXI Interface Core will respond with a DECERR (decode error) response to AXI read and write requests with an address value greater than this port setting. The Verilog parameter ADDR_MAP_SIG_BITS sets the number of significant bits that are used in the address value comparison.
0x13218 CFG_MEM_START_ADDRESS_AXI1_0
  [31:0] CFG_MEM_START_ADDRESS_AXI1_0 — Memory controller address offset for this AXI Interface. The value of cfg_mem_start_address is subtracted off of every AXI read and write request before being submitted to the memory controller.
0x1321C CFG_MEM_START_ADDRESS_AXI1_1
  [1:0] CFG_MEM_START_ADDRESS_AXI1_1 — Memory controller address offset for this AXI Interface. The value of cfg_mem_start_address is subtracted off of every AXI read and write request before being submitted to the memory controller.
0x13220 CFG_MEM_START_ADDRESS_AXI2_0
  [31:0] CFG_MEM_START_ADDRESS_AXI2_0 — Memory controller address offset for this AXI Interface. The value of cfg_mem_start_address is subtracted off of every AXI read and write request before being submitted to the memory controller.
0x13224 CFG_MEM_START_ADDRESS_AXI2_1
  [1:0] CFG_MEM_START_ADDRESS_AXI2_1 — Memory controller address offset for this AXI Interface. The value of cfg_mem_start_address is subtracted off of every AXI read and write request before being submitted to the memory controller.
0x13514 CFG_ENABLE_BUS_HOLD_AXI1
  [0] CFG_ENABLE_BUS_HOLD_AXI1 — For this AXI Interface, enables bus hold function that will stop arbitration in the MPFE when the read reorder buffer is full
0x13518 CFG_ENABLE_BUS_HOLD_AXI2
  [0] CFG_ENABLE_BUS_HOLD_AXI2 — For this AXI Interface, enables bus hold function that will stop arbitration in the MPFE when the read reorder buffer is full
0x13690 CFG_AXI_AUTO_PCH
  [31:0] CFG_AXI_AUTO_PCH — This is AXI interface register that can be configured to be 8, 16, or 32 bits wide depending upon the number of AXI ports supported. Bit 0 of this register is always associated with axi port 0, bit 1 with axi port 1, etc. If port Y uses a local bus interface, then cfg_axi_auto_pch[Y] is not used and is considered a don't care. If it is an axi port input, cfg_axi_auto_pch serves solely as the auto_pch control for that AXI port. When cfg_axi_auto_pch is set and a long (multibeat) AXI read or write is issued by user logic, then the NWL axi interface logic will insure that only the last sdram controller request being issued (on behalf of a single long AXI request) asserts auto_precharge. If a reorder core is included and is enabled (cfg_reorder_queue_en = 1), then cfg_ro_closed_page_policy, when set, overrides the cfg_axi_auto_pch input and forces auto_pch asserted on all outgoing requests from the reoder core.
0x3C000 PHY_RESET_CONTROL reset 0xD
  [15:0] PHY_RESET_CONTROL — Reset control register
0x3C004 PHY_PC_RANK
  [3:0] PHY_PC_RANK — Select which rank to be trained.
0x3C008 PHY_RANKS_TO_TRAIN
  [15:0] PHY_RANKS_TO_TRAIN — One hot encoding of which ranks to train during automatic initialization.
0x3C00C PHY_WRITE_REQUEST
  [0] PHY_WRITE_REQUEST — Request the memory controller to write to the SDRAM. Writes the eye training pattern into location 0 in the SDRAM
0x3C010 PHY_WRITE_REQUEST_DONE ro
  [0] PHY_WRITE_REQUEST_DONE rw — Indicate write request is completed
0x3C014 PHY_READ_REQUEST
  [0] PHY_READ_REQUEST — Request the memory controller to read from the SDRAM. Intended for gate training and eye training
0x3C018 PHY_READ_REQUEST_DONE ro
  [0] PHY_READ_REQUEST_DONE rw — Indicate read request is completed
0x3C01C PHY_WRITE_LEVEL_DELAY
  [5:0] PHY_WRITE_LEVEL_DELAY — Number of cycles to allow PHY response before sending another strobe.
0x3C020 PHY_GATE_TRAIN_DELAY
  [5:0] PHY_GATE_TRAIN_DELAY — Number of cycles to allow PHY response before sending the next read command.
0x3C024 PHY_EYE_TRAIN_DELAY
  [5:0] PHY_EYE_TRAIN_DELAY — Number of cycles to allow PHY response before sending the next read command.
0x3C028 PHY_EYE_PAT
  [7:0] PHY_EYE_PAT — Eye training pattern to be loaded into the phy and the SDRAM
0x3C02C PHY_START_RECAL
  [0] PHY_START_RECAL — Rerun write leveling, gate training, and eye training.
0x3C030 PHY_CLR_DFI_LVL_PERIODIC
  [0] PHY_CLR_DFI_LVL_PERIODIC — Clear PHY init SM Periodic Training incremental enable
0x3C034 PHY_TRAIN_STEP_ENABLE
  [5:0] PHY_TRAIN_STEP_ENABLE — PHY init state machine training step/stage enables, [5]: CA training, [4]: write leveling, [3]: read leveling, [2:0]: reserved
0x3C038 PHY_LPDDR_DQ_CAL_PAT
  [0] PHY_LPDDR_DQ_CAL_PAT — LPDDR2/3 DQ training pattern, 0:A,1010_1010,MR32 1:B,0011_0011,MR40
0x3C03C PHY_INDPNDT_TRAINING
  [0] PHY_INDPNDT_TRAINING — Set to 1'b1 to indicate that the PHY will perform training without requiring interaction from the MC. The PHY will start training at the assertion of ctrlr_init_done and will signal completion with dfi_training_complete.
0x3C040 PHY_ENCODED_QUAD_CS
  [0] PHY_ENCODED_QUAD_CS — Set to indicate configuration with DDR4 RDIMMs that have four ranks that encode chip-select down to 3 bits. When this port is set to '1', sd_cs_n[2:0] will only be used to designate rank selection to the RCD device. Refer to the JEDEC DDR4RCD01 DDR4 Registering Clock Driver (RCD) specification for details on how the Encoded Quad CS is used in an RDIMM application.
0x3C044 PHY_HALF_CLK_DLY_ENABLE
  [0] PHY_HALF_CLK_DLY_ENABLE — Set to enable 1/2 clock output delay of DQ/DQS datapath. Used to Align with RCD 1/2 clock delay.
