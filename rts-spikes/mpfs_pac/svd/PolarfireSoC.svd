# Polarfire SoC register map
Vendor: Microchip; File version: 1.0
CPU: Microchip PolarFire SoC 1.0, little endian
Registers are 32-bit, read-write, reset 0x0 unless marked. A register's access mark holds for its fields unless they carry their own. Offsets are from the block's base; [hi:lo] are bit positions; lines under a group give offsets from that group.

## DDR_CSR_APB (part 2 of 3) — DDR_CSR_APB Controller
Base 0x20082400
0x40D8 CFG_MEM_ROWBITS reset 0x10
  [4:0] CFG_MEM_ROWBITS — Number of bits in the row address.
0x40DC CFG_MEM_BANKBITS reset 0x3
  [2:0] CFG_MEM_BANKBITS — Number of bits in the bank address (including DDR4/HBM bank group bits). For HBM pseudo channel memory, the pseudo channel select bit (BA4 in the JEDEC specification) does not count as a bank bit. If using an 8HI stack, the SID address bit counts as another bank group bit. Thus when using an HBM 8HI stack the cfg_mem_bankbits should be set to 5 (= 4 + 1) .
0x40E0 CFG_ODT_RD_MAP_CS0 reset 0x2
  [7:0] CFG_ODT_RD_MAP_CS0 — ODT selection matrix for reads. Selects which ODT outputs are enabled when reading from each chip select. For example, if cfg_odt_rd_cs0 is set to '00001100', then sd_odt[2] and sd_odt[3] will be asserted during a read from memory devices on chip select 0. If the controller is configured to support 8 ranks, the width of each port will be 8 bits and cfg_odt_rd_map_cs8 through cfg_odt_rd_map_cs15 will be unused. If the controller is configured to support 16 ranks, the width of each port will be 16 bits.
0x40E4 CFG_ODT_RD_MAP_CS1 reset 0x1
  [7:0] CFG_ODT_RD_MAP_CS1 — ODT selection matrix for reads. Selects which ODT outputs are enabled when reading from each chip select. For example, if cfg_odt_rd_cs0 is set to '00001100', then sd_odt[2] and sd_odt[3] will be asserted during a read from memory devices on chip select 0. If the controller is configured to support 8 ranks, the width of each port will be 8 bits and cfg_odt_rd_map_cs8 through cfg_odt_rd_map_cs15 will be unused. If the controller is configured to support 16 ranks, the width of each port will be 16 bits.
0x40E8 CFG_ODT_RD_MAP_CS2 reset 0x8
  [7:0] CFG_ODT_RD_MAP_CS2 — ODT selection matrix for reads. Selects which ODT outputs are enabled when reading from each chip select. For example, if cfg_odt_rd_cs0 is set to '00001100', then sd_odt[2] and sd_odt[3] will be asserted during a read from memory devices on chip select 0. If the controller is configured to support 8 ranks, the width of each port will be 8 bits and cfg_odt_rd_map_cs8 through cfg_odt_rd_map_cs15 will be unused. If the controller is configured to support 16 ranks, the width of each port will be 16 bits.
0x40EC CFG_ODT_RD_MAP_CS3 reset 0x4
  [7:0] CFG_ODT_RD_MAP_CS3 — ODT selection matrix for reads. Selects which ODT outputs are enabled when reading from each chip select. For example, if cfg_odt_rd_cs0 is set to '00001100', then sd_odt[2] and sd_odt[3] will be asserted during a read from memory devices on chip select 0. If the controller is configured to support 8 ranks, the width of each port will be 8 bits and cfg_odt_rd_map_cs8 through cfg_odt_rd_map_cs15 will be unused. If the controller is configured to support 16 ranks, the width of each port will be 16 bits.
0x40F0 CFG_ODT_RD_MAP_CS4 reset 0x20
  [7:0] CFG_ODT_RD_MAP_CS4 — ODT selection matrix for reads. Selects which ODT outputs are enabled when reading from each chip select. For example, if cfg_odt_rd_cs0 is set to '00001100', then sd_odt[2] and sd_odt[3] will be asserted during a read from memory devices on chip select 0. If the controller is configured to support 8 ranks, the width of each port will be 8 bits and cfg_odt_rd_map_cs8 through cfg_odt_rd_map_cs15 will be unused. If the controller is configured to support 16 ranks, the width of each port will be 16 bits.
0x40F4 CFG_ODT_RD_MAP_CS5 reset 0x10
  [7:0] CFG_ODT_RD_MAP_CS5 — ODT selection matrix for reads. Selects which ODT outputs are enabled when reading from each chip select. For example, if cfg_odt_rd_cs0 is set to '00001100', then sd_odt[2] and sd_odt[3] will be asserted during a read from memory devices on chip select 0. If the controller is configured to support 8 ranks, the width of each port will be 8 bits and cfg_odt_rd_map_cs8 through cfg_odt_rd_map_cs15 will be unused. If the controller is configured to support 16 ranks, the width of each port will be 16 bits.
0x40F8 CFG_ODT_RD_MAP_CS6 reset 0x80
  [7:0] CFG_ODT_RD_MAP_CS6 — ODT selection matrix for reads. Selects which ODT outputs are enabled when reading from each chip select. For example, if cfg_odt_rd_cs0 is set to '00001100', then sd_odt[2] and sd_odt[3] will be asserted during a read from memory devices on chip select 0. If the controller is configured to support 8 ranks, the width of each port will be 8 bits and cfg_odt_rd_map_cs8 through cfg_odt_rd_map_cs15 will be unused. If the controller is configured to support 16 ranks, the width of each port will be 16 bits.
0x40FC CFG_ODT_RD_MAP_CS7 reset 0x40
  [7:0] CFG_ODT_RD_MAP_CS7 — ODT selection matrix for reads. Selects which ODT outputs are enabled when reading from each chip select. For example, if cfg_odt_rd_cs0 is set to '00001100', then sd_odt[2] and sd_odt[3] will be asserted during a read from memory devices on chip select 0. If the controller is configured to support 8 ranks, the width of each port will be 8 bits and cfg_odt_rd_map_cs8 through cfg_odt_rd_map_cs15 will be unused. If the controller is configured to support 16 ranks, the width of each port will be 16 bits.
0x4120 CFG_ODT_WR_MAP_CS0 reset 0x1
  [7:0] CFG_ODT_WR_MAP_CS0 — ODT selection matrix for writes. Selects which ODT outputs are enabled when writing to each chip select. For example, if cfg_odt_wr_cs0 is set to '00001100', then sd_odt[2] and sd_odt[3] will be asserted during a write to memory devices on chip select 0. If the controller is configured to support 8 ranks, the width of each port will be 8 bits and cfg_odt_wr_map_cs8 through cfg_odt_wr_map_cs15 will be unused. If the controller is configured to support 16 ranks, the width of each port will be 16 bits.
0x4124 CFG_ODT_WR_MAP_CS1 reset 0x2
  [7:0] CFG_ODT_WR_MAP_CS1 — ODT selection matrix for writes. Selects which ODT outputs are enabled when writing to each chip select. For example, if cfg_odt_wr_cs0 is set to '00001100', then sd_odt[2] and sd_odt[3] will be asserted during a write to memory devices on chip select 0. If the controller is configured to support 8 ranks, the width of each port will be 8 bits and cfg_odt_wr_map_cs8 through cfg_odt_wr_map_cs15 will be unused. If the controller is configured to support 16 ranks, the width of each port will be 16 bits.
0x4128 CFG_ODT_WR_MAP_CS2 reset 0x4
  [7:0] CFG_ODT_WR_MAP_CS2 — ODT selection matrix for writes. Selects which ODT outputs are enabled when writing to each chip select. For example, if cfg_odt_wr_cs0 is set to '00001100', then sd_odt[2] and sd_odt[3] will be asserted during a write to memory devices on chip select 0. If the controller is configured to support 8 ranks, the width of each port will be 8 bits and cfg_odt_wr_map_cs8 through cfg_odt_wr_map_cs15 will be unused. If the controller is configured to support 16 ranks, the width of each port will be 16 bits.
0x412C CFG_ODT_WR_MAP_CS3 reset 0x8
  [7:0] CFG_ODT_WR_MAP_CS3 — ODT selection matrix for writes. Selects which ODT outputs are enabled when writing to each chip select. For example, if cfg_odt_wr_cs0 is set to '00001100', then sd_odt[2] and sd_odt[3] will be asserted during a write to memory devices on chip select 0. If the controller is configured to support 8 ranks, the width of each port will be 8 bits and cfg_odt_wr_map_cs8 through cfg_odt_wr_map_cs15 will be unused. If the controller is configured to support 16 ranks, the width of each port will be 16 bits.
0x4130 CFG_ODT_WR_MAP_CS4 reset 0x10
  [7:0] CFG_ODT_WR_MAP_CS4 — ODT selection matrix for writes. Selects which ODT outputs are enabled when writing to each chip select. For example, if cfg_odt_wr_cs0 is set to '00001100', then sd_odt[2] and sd_odt[3] will be asserted during a write to memory devices on chip select 0. If the controller is configured to support 8 ranks, the width of each port will be 8 bits and cfg_odt_wr_map_cs8 through cfg_odt_wr_map_cs15 will be unused. If the controller is configured to support 16 ranks, the width of each port will be 16 bits.
0x4134 CFG_ODT_WR_MAP_CS5 reset 0x20
  [7:0] CFG_ODT_WR_MAP_CS5 — ODT selection matrix for writes. Selects which ODT outputs are enabled when writing to each chip select. For example, if cfg_odt_wr_cs0 is set to '00001100', then sd_odt[2] and sd_odt[3] will be asserted during a write to memory devices on chip select 0. If the controller is configured to support 8 ranks, the width of each port will be 8 bits and cfg_odt_wr_map_cs8 through cfg_odt_wr_map_cs15 will be unused. If the controller is configured to support 16 ranks, the width of each port will be 16 bits.
0x4138 CFG_ODT_WR_MAP_CS6 reset 0x40
  [7:0] CFG_ODT_WR_MAP_CS6 — ODT selection matrix for writes. Selects which ODT outputs are enabled when writing to each chip select. For example, if cfg_odt_wr_cs0 is set to '00001100', then sd_odt[2] and sd_odt[3] will be asserted during a write to memory devices on chip select 0. If the controller is configured to support 8 ranks, the width of each port will be 8 bits and cfg_odt_wr_map_cs8 through cfg_odt_wr_map_cs15 will be unused. If the controller is configured to support 16 ranks, the width of each port will be 16 bits.
0x413C CFG_ODT_WR_MAP_CS7 reset 0x80
  [7:0] CFG_ODT_WR_MAP_CS7 — ODT selection matrix for writes. Selects which ODT outputs are enabled when writing to each chip select. For example, if cfg_odt_wr_cs0 is set to '00001100', then sd_odt[2] and sd_odt[3] will be asserted during a write to memory devices on chip select 0. If the controller is configured to support 8 ranks, the width of each port will be 8 bits and cfg_odt_wr_map_cs8 through cfg_odt_wr_map_cs15 will be unused. If the controller is configured to support 16 ranks, the width of each port will be 16 bits.
0x4160 CFG_ODT_RD_TURN_ON
  [3:0] CFG_ODT_RD_TURN_ON — Allows timing adjustments for the ODT signals during reads. Value is expressed in two's compliment form and represents the amount of shift from the nominal value of ODT turn-on and turn-off timing during reads. -8 ('b1000) - negative shift of 8 clocks ... -1 ('b1111) - negative shift of 1 clock 0 ('b0000) - use standard ODT timing 1 ('b0001) - positive shift of transition timing ... 7 ('b0111) - positive shift of 7 clocks Typically only a value of '0' will be used. However, negative values can be used to advance the turn-on relative to the nominal, while positive values will delay it.
0x4164 CFG_ODT_WR_TURN_ON
  [3:0] CFG_ODT_WR_TURN_ON — Allows timing adjustments for the ODT signals during writes. Value is expressed in two's compliment form and represents the amount of shift from the nominal value of ODT turn-on and turn-off timing during writes. -8 ('b1000) - negative shift of 8 clocks ... -1 ('b1111) - negative shift of 1 clock 0 ('b0000) - use standard ODT timing 1 ('b0001) - positive shift of transition timing ... 7 ('b0111) - positive shift of 7 clocks Typically only a value of '0' will be used. However, negative values can be used to advance the turn-on relative to the nominal, while positive values will delay it.
0x4168 CFG_ODT_RD_TURN_OFF
  [3:0] CFG_ODT_RD_TURN_OFF — See description for cfg_odt_rd_turn_on.
0x416C CFG_ODT_WR_TURN_OFF
  [3:0] CFG_ODT_WR_TURN_OFF — See description for cfg_odt_wr_turn_on.
0x4178 CFG_EMR3
  [15:0] CFG_EMR3 — Value programmed into Extended Mode Register 3 during initialization for DDR2 and DDR3 memory types. Typically this is set to 0. This port is provided in case additional bits are defined in this mode register at a future time. This field is ignored for all memory types other than DDR2 and DDR3.
0x417C CFG_TWO_T
  [0] CFG_TWO_T — Two cycle timing (2T) enable. When enabled, the controller extends the duration of all signals in the SDRAM address and control bus, except 'sd_cs_n' to be two clock cycles. 'sd_cs_n' is only asserted on either the first or second cycle, as specified by 'cfg_two_t_sel_cycle'. 2T timing is not supported when cfg_regdimm is set to '1'. 0 - disable 1 - enable For half-rate or quarter-rate memory controller configurations this must be set to 0. For half-rate configurations 2T timing is provided automatically. For quarter-rate configurations 4T timing is provided automatically.
0x4180 CFG_TWO_T_SEL_CYCLE
  [0] CFG_TWO_T_SEL_CYCLE — Controls which memory clock cycle of a multi-cycle command that cs_n is asserted on. For full-rate configurations: 0 - cs_n asserted during the first cycle 1 - cs_n asserted during the second cycle This setting is ignored if 'cfg_two_t' is set to 0. For half-rate configurations: 0 - cs_n asserted during the first cycle. For DDR4, cs_n assertion may occur on the second cycle unless 'cfg_ccd_l' and 'cfg_ccd_s' settings are even numbers. Additionally, if write CRC is enabled 'cfg_ccd_s' must be set to 6. 1 - cs_n asserted during the second cycle. When this setting is used with DDR4, 'cfg_ccd_l' and 'cfg_ccd_s' settings must be even numbers. Additionally, if write CRC is enabled, 'cfg_ccd_s' must be set to 6. 'cfg_two_t' must be set to 0 for half-rate configurations. For quarter-rate configurations: 0 - cs_n asserted during the first cycle 1 - cs_n asserted during the third cycle 'cfg_two_t' must be set to 0 for quarter-rate configurations.
0x4184 CFG_REGDIMM
  [0] CFG_REGDIMM — Set when using Registered DIMMs (RDIMMs) and Load-Reduced DIMMs (LRDIMMs). When using RDIMMs or LRDIMMs, 'cfg_rdimm_lat' typically needs to be set to a value corresponding to the number of clocks the DIMM register device adds to the command/address path. For DDR3 RDIMMs and LRDIMMs, cfg_only_srank_cmds also needs to be set to prevent multiple chip selects from asserting simultaneously (which can be interpreted by DDR3 register devices as a control word write).
0x4188 CFG_MOD reset 0xC
  [4:0] CFG_MOD — SDRAM Mode Register Set command to any command (tMOD), specified in clocks. Min=24 for DDR4, 15 for HBM
0x418C CFG_XS reset 0x120
  [9:0] CFG_XS — SDRAM exit self-refresh to non-DLL command (tXS), specified in clocks.
0x4190 CFG_XSDLL reset 0x200
  [10:0] CFG_XSDLL — SDRAM exit self-refresh to any command requiring a locked DLL (tXSDLL), specified in clocks. Refer to memory device datasheet for the minimum required value based on the speed grade being used. If minimizing self-refresh exit time is not important to system performance (or if self-refresh is not being used) then a value that is larger than specified minimum can be used. For DDR3, a value of 512 exceeds the minimum required value for all speed grades. For DDR4, a value of 1024 exceeds the minimum required value for all speed grades.
0x4194 CFG_XPR reset 0x120
  [9:0] CFG_XPR — Delay from CKE high to valid command, after exiting reset (tXPR). Specified in clocks.
0x4198 CFG_AL_MODE
  [1:0] CFG_AL_MODE — Additive latency mode 0 - Additive Latency Disabled (AL = 0) 1 - AL = CL - 1 (not valid for 3DS DDR4 SDRAM) 2 - AL = CL - 2 3 - AL = CL - 3 (only valid for 3DS DDR4 SDRAM)
0x419C CFG_CWL reset 0x8
  [4:0] CFG_CWL — SDRAM CAS write latency, specified in clocks. Refer to SDRAM datasheet for list of supported values.
0x41A0 CFG_BL_MODE
  [1:0] CFG_BL_MODE — SDRAM burst length mode. This value sets the DDR3 or DDR4 burst length mode. The burst length mode determines the number of DDR transfers per burst. For "full-rate" configurations of the controller, values are decoded as follows: cfg_bl_mode = 0x0 - Fixed BL8 mode. 8 DDR transfers, 4 local side transfers per request cfg_bl_mode = 0x1 - BL8 or BC4 with on-the-fly selection cfg_bl_mode = 0x2 - Fixed BC4 (chop) (NOT CURRENTLY SUPPORTED) For "half-rate" configurations of the controller, values are decoded as follows: cfg_bl_mode = 0x0 - Fixed BL8 mode. 8 DDR transfers, 2 local side transfers per request cfg_bl_mode = 0x1 - BL8 or BC4 with on-the-fly selection cfg_bl_mode = 0x2 - Fixed BC4 (chop) (NOT CURRENTLY SUPPORTED) For "quarter-rate" configurations of the controller, there is only 1 local side transfer per request. Therefore, only one mode is supported: cfg_bl_mode = 0x0 - Fixed BL8 mode. 8 DDR transfers, 1 local side transfers per request cfg_bl_mode = 0x1 - BL8 or BC4 with on-the-fly selection (NOT SUPPORTED) cfg_bl_mode = 0x2 - Fixed BC4 (chop) (NOT SUPPORTED) Note: Refer to the SDRAM Controller Core User Guide for information on using non-aligned starting addresses with each burst length setting.
0x41A4 CFG_TDQS
  [0] CFG_TDQS — Termination DQS enable. This signal is written into "TDQS enable" field of mode register during initialization sequence. Enables or disables the TDQS pin on all devices 0 - disable TDQS / enable data mask functionality 1 - enable TDQS / disable data mask functionality
0x41A8 CFG_RTT_WR
  [2:0] CFG_RTT_WR — Dynamic ODT effective resistance (Rtt_wr). On-Die Termination effective resistance setting programmed into "RTT_WR" field of mode register during initialization sequence. Refer to SDRAM device datasheet for the mapping to impedance values.
0x41AC CFG_LP_ASR
  [1:0] CFG_LP_ASR — Low Power Array Self Refresh (LP ASR) setting, DDR4 ONLY. Programmed into SDRAM device Mode Register during initialization sequence. Refer to SDRAM device datasheet for more information on LP_ASR.
0x41B0 CFG_AUTO_SR
  [0] CFG_AUTO_SR — Auto Self Refresh (ASR) setting, DDR3 ONLY. Programmed into SDRAM device Mode Register during initialization sequence. Refer to SDRAM device datasheet for more information on ASR.
0x41B4 CFG_SRT
  [0] CFG_SRT — Self Refresh Temperature (SRT) setting, DDR3 ONLY. Programmed into SDRAM device Mode Register during initialization sequence. Refer to SDRAM device datasheet for more information on SRT.
0x41B8 CFG_ADDR_MIRROR
  [7:0] CFG_ADDR_MIRROR — Each bit is associated with the respective rank (bit 0 = rank 0, bit 7 = rank 7). If the bit is high, it indicates to the controller that that rank is using address mirroring on the DIMM layout.
0x41BC CFG_ZQ_CAL_TYPE
  [1:0] CFG_ZQ_CAL_TYPE — Type of ZQ calibration to be performed during automatic periodic ZQ calibrations or when user asserts 'l_zq_cal_req' or 'init_zq_cal_req'. Only used for DDR3, DDR4, LPDDR2, and LPDDR3 memory types. 0 - Short ZQ calibration (DDR3/DDR4/LPDDR2/LPDDR3) - The controller issues short ZQ-cal command and holds off subsequent commands until the delay specified by 'cfg_zq_cal_s_duration' is satisfied. 1 - Long ZQ calibration (DDR3/DDR4/LPDDR2/LPDDR3) - The controller issues a long ZQ-cal command and holds off subsequent commands until the delay specified by 'cfg_zq_cal_l_duration' is satisfied. 2 - Reset ZQ calibration (LPDDR2/LPDDR3) - The controller issues a reset ZQ-cal command and holds off subsequent commands until the delay specified by 'cfg_zq_cal_r_duration' is satisfied. 3 - Initialization ZQ calibration (LPDDR2/LPDDR3/DDR3/DDR4) - The controller issues a ZQINIT command (LPDDR2/LPDDR3) or long ZQ-cal command (DDR3/DDR4) and holds off subsequent commands until the delay specified by 'cfg_zqinit_cal_duration' is satisfied.
0x41C0 CFG_ZQ_CAL_PER reset 0x3F40
  [31:0] CFG_ZQ_CAL_PER — Period between automatic ZQ calibration commands issued by the controller, specified in memory clocks. The ZQ calibration is performed on a single rank at a time. Therefore the period between ZQ calibration commands in the system is the period specified divided by the number of ranks in the system (cfg_num_ranks). In this way each rank receives a ZQ calibration once per cfg_zq_cal_per.
0x41C4 CFG_AUTO_ZQ_CAL_EN reset 0x1
  [0] CFG_AUTO_ZQ_CAL_EN — Enables automatic generation of ZQ calibration commands at a periodic rate determined by 'cfg_zq_cal_per'. When this is set to '0', the user logic must initiate periodic ZQ calibrations manually using the 'l_zq_cal_req' input.
0x41C8 CFG_MEMORY_TYPE reset 0x8
  [15:0] CFG_MEMORY_TYPE — Applies to multi-mode memory controller configurations only. Selects memory type being used. 0x0004 = DDR2 0x0008 = DDR3 0x0020 = LPDDR2 0x0040 = RL3 0x0080 = DDR4 0x0100 = LPDDR3 0x0400 = LPDDR4 0x0800 = HBM2 legacy emulation using Pseudo channel memory 0x1000 = HBM2 native Pseudo channel memory 0x2000 = LL-HBM2 Pseudo channel memory
0x41CC CFG_ONLY_SRANK_CMDS
  [0] CFG_ONLY_SRANK_CMDS — When set, controller only issues commands to one rank at a time (i.e. only one chip select is ever asserted). Reasons for setting this include: 1) Use of DDR3 RDIMMs and DDR3 LRDIMMs. This must be set for DDR3 RDIMMs and DDR3 LRDIMMs since they do not allow commands to be issued to multiple ranks simultaneously. 2) Staggered refresh commands to reduce instantaneous current draw. 3) Enable read/write commands while other ranks are being refreshed. To utilize this, the user logic must be aware of which rank is about to be refreshed and avoid requests to that rank. When this is set, the refresh period provided on 'cfg_ref_per' will be divided internally in the controller by the number of ranks in the system (as specified by 'cfg_num_ranks') since each refresh event is only refreshing one rank. See the cfg_ref_per register description for details.
0x41D0 CFG_NUM_RANKS reset 0x2
  [4:0] CFG_NUM_RANKS — Number of ranks in system. Used by ZQ-calibration and when cfg_only_srank_cmds is set to determine which ranks to cycle through for refresh and ZQ-calibration commands.
0x41D4 CFG_QUAD_RANK
  [0] CFG_QUAD_RANK — Set to indicate configuration with DIMMs that have four ranks. Quad-rank DIMMs expose two CKE pins, each driving two ranks. When this port is set to '1', ranks will only be put into power down and self-refresh in pairs which share CKE pins.
0x41DC CFG_EARLY_RANK_TO_WR_START
  [2:0] CFG_EARLY_RANK_TO_WR_START — Controls timing behavior of dfi_wrdata_cs_pN relative to dfi_wrdata_en_pN. When set to 0, dfi_wrdata_cs_pN is guaranteed to be valid only while dfi_wrdata_en_pN is asserted. When set to 1, dfi_wrdata_cs_pN will also be guaranteed valid 1 DFI clock cycle prior to dfi_wrdata_en_pN, and will remain valid while dfi_wrdata_en_pN is valid. A value of 1 may cause the controller to delay a write to a different rank from the previous write in order to guarantee this timing. Some PHYs require a setting of 1 so that there is time for rank-specific delay values to be switched in prior to the start of data transfer on the DRAM bus. Only values of 1 and 0 are permitted.
0x41E0 CFG_EARLY_RANK_TO_RD_START
  [2:0] CFG_EARLY_RANK_TO_RD_START — Controls timing behavior of dfi_rddata_cs_pN relative to dfi_rddata_en_pN. When set to 0, dfi_rddata_cs_pN is guaranteed to be valid only while dfi_rddata_en_pN is asserted. When set to 1, dfi_rddata_cs_pN will also be guaranteed valid 1 DFI clock cycle prior to dfi_rddata_en_pN, and will remain valid while dfi_rddata_en_pN is valid. A value of 1 may cause the controller to delay a read to a different rank from the previous read in order to guarantee this timing. Some PHYs require a setting of 1 so that there is time for rank-specific delay values to be switched in prior to the start of data transfer on the DRAM bus. Only values of 1 and 0 are permitted.
0x41E4 CFG_PASR_BANK
  [7:0] CFG_PASR_BANK — Partial-Array Self-Refresh Bank Mask settings programmed into the Mode Register.
0x41E8 CFG_PASR_SEG
  [7:0] CFG_PASR_SEG — Partial-Array Self-Refresh Segment Mask settings programmed into the Mode Register.
0x41EC INIT_MRR_MODE
  [0] INIT_MRR_MODE — Set to direct SDRAM controller to issue mode register read commands for subsequent read accesses. It is recommended that this only be asserted when init_cal_select = 1'b1, or when the controller is idle (no other read/write activity in progress).
0x41F0 INIT_MR_W_REQ
  [0] INIT_MR_W_REQ — Mode register write request. Initiates a mode register program to the mode register specified by init_mr_addr and rank(s) specified by init_cs. Assertion of init_ack signals the completion of the operation. All banks must be closed prior to making this request. This may be done using the init_precharge register.
0x41F4 INIT_MR_ADDR
  [7:0] INIT_MR_ADDR — Mode register address to be written to when init_mr_w_req is asserted.
0x41F8 INIT_MR_WR_DATA
  [17:0] INIT_MR_WR_DATA — Value to be programmed into mode register. For HBM only bits 7 to 0 are used (OP7 = init_mr_wrdata[7],... OP0 = init_mr_wrdata[0]).
0x41FC INIT_MR_WR_MASK
  [17:0] INIT_MR_WR_MASK — Mask for mode register writes. Mode register bits corresponding to bits asserted in this bus will be sourced from settings on cfg_* inputs to the controller rather than the init_mr_wr_data bus.
0x4200 INIT_NOP
  [0] INIT_NOP — Causes controller to issue NOP command. For DDR4, typically used for geardown mode.
0x4204 CFG_INIT_DURATION reset 0x29B0
  [15:0] CFG_INIT_DURATION — Delay (tINIT5) after initialization RESET command that the controller waits before issuing ZQ initialization calibration (ZQINIT) command, specified in clocks.
0x4208 CFG_ZQINIT_CAL_DURATION reset 0x200
  [11:0] CFG_ZQINIT_CAL_DURATION — Delay from initialization ZQ calibration command to any subsequent command, specified in memory clocks. Based on tZQINIT timing specification. For DDR3, DDR4, LPDDR2 and LPDDR3 memory types this applies to the ZQ calibration command performed during the automatic initialization sequence. For DDR3 and DDR4 memory types, this also applies to any long ZQ calibration performed when 'cfg_zq_cal_type' is set to 3.
0x420C CFG_ZQ_CAL_L_DURATION reset 0x100
  [10:0] CFG_ZQ_CAL_L_DURATION — Delay from long ZQ-cal command to any subsequent command, specified in memory clocks. Based on tZQCL timing specification for DDR3, LPDDR2 and LPDDR3. Based on tZQOper timing specification for DDR4.
0x4210 CFG_ZQ_CAL_S_DURATION reset 0x40
  [10:0] CFG_ZQ_CAL_S_DURATION — Delay from short ZQ-cal command to any subsequent command, specified in memory clocks. Based on tZQCS timing specification.
0x4214 CFG_ZQ_CAL_R_DURATION reset 0x35
  [10:0] CFG_ZQ_CAL_R_DURATION — Delay from ZQ-cal reset command to any subsequent command, specified in memory clocks. Based on tZQRESET timing specification.
0x4218 CFG_MRR reset 0x2
  [3:0] CFG_MRR — Mode register read command to valid mode read data (tMRR), specified in clocks.
0x421C CFG_MRW reset 0xC
  [4:0] CFG_MRW — Mode register write command period (tMRW), specified in clocks.
0x4220 CFG_ODT_POWERDOWN
  [0] CFG_ODT_POWERDOWN — Set to enable ODT during powerdown.
0x4224 CFG_WL reset 0x8
  [5:0] CFG_WL — Write latency, specified in clocks. Valid values for HBM are 6 through 8. Valid values for LPDDR4 are 4 through 34. Valid values for GDDR6 are 5 through 8.
0x4228 CFG_RL reset 0xB
  [5:0] CFG_RL — Read latency, specified in clocks.
0x422C CFG_CAL_READ_PERIOD
  [21:0] CFG_CAL_READ_PERIOD — Period between calibration reads, specified in clocks. Set to 0 to disable periodic calibration reads. [This port only included in PHY configurations which require periodic calibration reads.]
0x4230 CFG_NUM_CAL_READS
  [1:0] CFG_NUM_CAL_READS — Number of calibration reads that are issued each time cfg_cal_read_period timer expires. [This port only included in PHY configurations which require periodic calibration reads.]
0x4234 INIT_SELF_REFRESH
  [7:0] INIT_SELF_REFRESH — Self-refresh control. Causes the controller to put the selected SDRAM rank (chip select) into self-refresh mode at the next refresh event. Each bit in init_self_refresh corresponds to the selected rank; asserting init_self_refresh[0] puts the devices connected to cs_n[0] into self refresh, init_self_refresh[1] for cs_n[1] and so on. This bus performs the same function as l_self_refresh, however this bus is first level-synchronized to the memory controller clock domain within the controller. This allows it to be controlled from a different clock domain, as is typically the case when driven from a control / status register (CSR) module.
0x4238 INIT_SELF_REFRESH_STATUS ro
  [7:0] INIT_SELF_REFRESH_STATUS — Indicates which ranks are in self-refresh
0x423C INIT_POWER_DOWN
  [7:0] INIT_POWER_DOWN — Power down control. Causes the controller to put the selected SDRAM rank (chip select) into power down mode. The core will automatically continue to refresh all devices so that data is retained. This bus performs the same function as l_power_down, however this bus is first level-synchronized to the memory controller clock domain within the controller. This allows it to be controlled from a different clock domain, as is typically the case when driven from a control / status register (CSR) module.
0x4240 INIT_POWER_DOWN_STATUS ro
  [7:0] INIT_POWER_DOWN_STATUS — Indicates which ranks are in power-down
0x4244 INIT_FORCE_WRITE
  [0] INIT_FORCE_WRITE — Forces assertion of 'dfi_wrdata_en' and 'dfi_odt' which will cause the PHY to drive its DQ, DQS and ODT outputs, regardless of whether a write command is issued or not. This feature can be used for software-driven write leveling as well as hardware debug of the write interface. When init_force_write is asserted and a regular write is not being driven by the controller, the data pattern is specified by 'init_force_write_data', and the rank driven to 'dfi_wrdata_cs' is specified by 'init_force_write_cs'. Whenever a regular write is being driven by the controller, the data pattern and rank come from the normal controller path, regardless of the state of 'init_force_write'.
0x4248 INIT_FORCE_WRITE_CS
  [7:0] INIT_FORCE_WRITE_CS — Rank passed to PHY on dfi_wrdata_cs when init_force_write is asserted and a regular write is not being driven.
0x424C CFG_CTRLR_INIT_DISABLE
  [0] CFG_CTRLR_INIT_DISABLE — Controller initialization is bypassed when asserted, allowing PHY to perform initialization instead.
0x4250 CTRLR_READY ro
  [0] CTRLR_READY — Deasserted when in reset or after ctrlr_init is asserted, then asserts after initialization sequence and training sequences (if required) have completed
0x4254 INIT_RDIMM_READY ro
  [0] INIT_RDIMM_READY rw — Signals to the application that the reset sequence has completed and that it may proceed with writing to the Register Control Words (RCW) and/or Buffer Control Words (BCW) of the RDIMM/LRDIMM, using the 'init_mr_w_req', 'init_mr_addr' and 'init_mr_wr_data' controls.
0x4258 INIT_RDIMM_COMPLETE
  [0] INIT_RDIMM_COMPLETE — Set by the application to indicate that it has completed writing to the Register Control Word (RCW) and/or Buffer Control Words (BCW) of the RDIMM/LRDIMM. This enables the controller to proceed with the device initialization. If the application does not need to write to the RCWs or BCWs, it may set this control high all the time.
0x425C CFG_RDIMM_LAT
  [2:0] CFG_RDIMM_LAT — Specifies the latency of the register device used in Registered DIMMs (RDIMMs) and Load-Reduced DIMMs (LRDIMMs). This value is used to delay data-path related signal timing going to the PHY to compensate for the extra latency in the DIMM. For DDR2 and DDR3 RDIMMs, as well as DDR3 LRDIMMs, the register device always introduces a latency of 1 clock on the command and address signals. For DDR4 RDIMMs and LRDIMMs, the register clock driver (RCD) introduces a latency of at least 1 clock on the command and address signals. It can introduce additional latency (up to 4 additional clocks) based on the "Command Latency Adder" control word setting in the RCD. In most cases, this setting should reflect the exact value of latency introduced by the RDIMM or LRDIMM register device. An exception is when the controller is integrated with a PHY that automatically compensates for the RDIMM or LRDIMM latency during its training sequence, and expects the same data-path related signal timing regardless of the amount of latency introduced by the register device.
0x4260 CFG_RDIMM_BSIDE_INVERT reset 0x1
  [0] CFG_RDIMM_BSIDE_INVERT — Set to 1 to indicate that the DDR4 RDIMM register clock driver (RCD) will invert the B-side addresses.
0x4264 CFG_LRDIMM
  [0] CFG_LRDIMM — Set to 1 to indicate DDR4 LRDIMM is installed in the system.
0x4268 INIT_MEMORY_RESET_MASK
  [0] INIT_MEMORY_RESET_MASK — When set, masks the reset output of the controller (dfi_reset_n_pN) so that it does not assert when the controller is in reset. This function can be useful in situations where the memory controller needs to be reset while holding the memory devices in the self-refresh state. This signal is connected to the reset_n pin of level synchronization flip-flops inside the memory controller. This guarantees synchronous assertion of the internal masking logic when the init_memory_reset_mask signal is not synchronized to the memory controller clock. However, this method does not guarantee synchronous de-assertion of the internal masking logic when init_memory_reset_mask transitions from 1 to 0. Therefore, 1 to 0 transitions should only happen while the memory controller is in reset (reset_n = 0).
0x426C CFG_RD_PREAMB_TOGGLE
  [0] CFG_RD_PREAMB_TOGGLE — Sets read preamble toggle bit in the mode register.
0x4270 CFG_RD_POSTAMBLE
  [0] CFG_RD_POSTAMBLE — Sets read postamble length bit in the mode register.
0x4274 CFG_PU_CAL
  [0] CFG_PU_CAL — Sets pullup calibration point bit in the mode register.
0x4278 CFG_DQ_ODT
  [2:0] CFG_DQ_ODT — Sets DQ ODT value in the mode register.
0x427C CFG_CA_ODT
  [2:0] CFG_CA_ODT — Sets CA ODT value in the mode register.
0x4280 CFG_ZQLATCH_DURATION reset 0x30
  [7:0] CFG_ZQLATCH_DURATION — Sets ZQ latch duration (tZQLAT) in memory clocks. Only applies to LPDDR4. This is the amount of time that the command bus must be in the deselect state after the ZQCAL latch command is issued by the controller.
0x4284 INIT_CAL_SELECT
  [0] INIT_CAL_SELECT — Calibration port select. Set to '1' prior to using init_cal_l_r_req to initiate a read on the memory bus.
0x4288 INIT_CAL_L_R_REQ
  [0] INIT_CAL_L_R_REQ — A rising edge detected in this register setting causes a single read command to be issued by the controller.
0x428C INIT_CAL_L_B_SIZE
  [3:0] INIT_CAL_L_B_SIZE — Burst size for read requested using init_cal_l_r_req.
0x4290 INIT_CAL_L_R_ACK ro
  [0] INIT_CAL_L_R_ACK rw — Asserts to acknowledge read requested by init_cal_l_r_req. Asserted when the read command has been accepted.
0x4294 INIT_CAL_L_READ_COMPLETE ro
  [0] INIT_CAL_L_READ_COMPLETE rw — Asserts to acknowledge read requested by init_cal_l_r_req. Asserted when the read command has occurred on the memory bus and the read data has been transferred.
0x42A0 INIT_RWFIFO
  [0] INIT_RWFIFO — Enables read/write access to the device FIFO. When set subsequent accesses are directed to FIFO rather than memory array until this bit is cleared. Rank is selected with init_cs register.
0x42A4 INIT_RD_DQCAL
  [0] INIT_RD_DQCAL — Enables reading of DQ calibration pattern. When set any read will generate a DQ calibration read until this bit is cleared. Rank is selected with init_cs register.
0x42A8 INIT_START_DQSOSC
  [0] INIT_START_DQSOSC — Issues a Start DQS Oscillator command to the memory device. Rank is selected with init_cs register.
0x42AC INIT_STOP_DQSOSC
  [0] INIT_STOP_DQSOSC — Issues a Stop DQS Oscillator command to the memory device. Rank is selected with init_cs register.
0x42B0 INIT_ZQ_CAL_START
  [0] INIT_ZQ_CAL_START — Issues a ZQ calibration start command to the memory device. Rank is selected with init_cs register.
0x42B4 CFG_WR_POSTAMBLE
  [0] CFG_WR_POSTAMBLE — Sets write postamble bit in the mode register.
0x42BC INIT_CAL_L_ADDR_0
  [31:0] INIT_CAL_L_ADDR_0 — Address used for read requested using init_cal_l_r_req.
0x42C0 INIT_CAL_L_ADDR_1
  [6:0] INIT_CAL_L_ADDR_1 — Address used for read requested using init_cal_l_r_req.
0x42C4 CFG_CTRLUPD_TRIG reset 0x1
  [2:0] CFG_CTRLUPD_TRIG — Specifies the trigger for the controller initiated update signal ('dfi_ctrlupd_req'). 0 - Disable 1 - Any refresh event triggers controller initiated update request 2 - Any ZQ-calibration event triggers controller initiated update request (for memory technologies that support it)
0x42C8 CFG_CTRLUPD_START_DELAY reset 0x16
  [9:0] CFG_CTRLUPD_START_DELAY — Delay from the DFI MC-initiated update trigger event command (as specified by 'cfg_ctrlupd_trig') to when the controller asserts 'dfi_ctrlupd_req'. This delay is specified in DFI clocks and is measured at the DFI interface to the PHY and can take on values of 0 (not recommended) to 1023. When DDR4 Command-Address-Latency (CAL) mode is used, the delay is from the assertion of the command at the DFI interface (which occurs sometime after the associated chip-select assertion in CAL mode). Note that this register defaults to the minimum recommended value of 5; however it is possible that some phys that support dfi_ctrlupd_req will require a larger cfg_ctrlupd_start_delay value to guarantee that a previous read in progress has completed before the NWL controller asserts dfi_ctrlupd_req as determined by this value and the cfg_ctrlupd_trig CSR.
0x42CC CFG_DFI_T_CTRLUPD_MAX reset 0xC8
  [9:0] CFG_DFI_T_CTRLUPD_MAX — Duration of 'dfi_ctrlupd_req' assertion. 0 - 'dfi_ctrlupd_req' will only de-assert after 'dfi_ctrlupd_ack' is asserted and then deasserted. 1-1023 - Duration of 'dfi_ctrlupd_req' assertion, specified in dfi clocks. 'dfi_ctrlupd_req' will deassert if 'dfi_ctrlupd_ack' asserts and deasserts before this time has elapsed. Otherwise 'dfi_ctrlupd_req' will deassert immediately after this time has elapsed.
0x42D0 CFG_CTRLR_BUSY_SEL
  [0] CFG_CTRLR_BUSY_SEL — Selects source of dfi_ctrlr_busy signal going to PHY 0 - dfi_ctrlr_busy generated based on read/write traffic and delay timings specified by cfg_ctrlr_busy_turn_off_delay, cfg_ctrlr_busy_slow_restart_window, and cfg_ctrlr_busy_restart_holdoff 1 - dfi_ctrlr_busy driven by static value specified by cfg_ctrlr_busy_value. This mode is typically used only for debug or for disabling the dynamic ctrlr_busy functionality.
0x42D4 CFG_CTRLR_BUSY_VALUE
  [0] CFG_CTRLR_BUSY_VALUE — Value driven on dfi_ctrlr_busy going to PHY if cfg_ctrlr_busy_sel = 1
0x42D8 CFG_CTRLR_BUSY_TURN_OFF_DELAY
  [8:0] CFG_CTRLR_BUSY_TURN_OFF_DELAY — Delay from last dfi_rddata_en or dfi_wrdata_en to deassertion of dfi_ctrlr_busy.
0x42DC CFG_CTRLR_BUSY_SLOW_RESTART_WINDOW
  [6:0] CFG_CTRLR_BUSY_SLOW_RESTART_WINDOW — If a command is received while the window is active then assert busy and then wait for restart holdoff before sending commands to the controller. If a command is received after the window is closed then assert busy and allow commands to go to the controller immediately. If the window is programmed to 0 then always wait for the command holdoff.
0x42E0 CFG_CTRLR_BUSY_RESTART_HOLDOFF
  [6:0] CFG_CTRLR_BUSY_RESTART_HOLDOFF — The delay from asserting busy = 1 to allowing commands to go the controller. If this is 0 then dfi_ctrlr_busy is always 1 and commands are never held off. This delay is also used when init_force_write is asserted to assure that there is enough time between the assertion of dfi_ctrlr_busy and the assertion of dfi_wrdata_en.
0x42E4 CFG_PARITY_RDIMM_DELAY reset 0x1
  [0] CFG_PARITY_RDIMM_DELAY — Delay the command address parity_in signal by 1 cycle. Typically needed to be set to 1 with regdimm configurations. Some PHYs provide this delay, in which case it should be set to 0.
0x42E8 CFG_CTRLR_BUSY_ENABLE
  [0] CFG_CTRLR_BUSY_ENABLE — Enables the controller busy function. If cfg_ctrlr_busy_enable is set to 0 dfi_ctrlr_busy is always high.
0x42EC CFG_ASYNC_ODT
  [0] CFG_ASYNC_ODT — Enable asynchronous ODT operation for non-DLL mode of operation. 0 - disable asynchronous ODT operation 1 - enable asynchronous ODT operation
0x42F0 CFG_ZQ_CAL_DURATION reset 0x640
  [11:0] CFG_ZQ_CAL_DURATION — Delay from LPDDR4 ZQ-cal start command to ZQ-cal latch command, specified in memory clocks. Based on LPDDR4 tZQCAL timing specification.
0x42F4 CFG_MRRI
  [5:0] CFG_MRRI — Additional time required following power-down state before issuing a command (tMRRI). Time from power-down exit to first command is tXP + tMRRI.
0x42F8 INIT_ODT_FORCE_EN
  [0] INIT_ODT_FORCE_EN — Turn on ODT per write selection matrix specified by 'cfg_odt_wr_map_csN' ports. Rank is specified by 'init_odt_force_rank'. This port may be used to set up the ODT signals for user controlled write leveling.
0x42FC INIT_ODT_FORCE_RANK
  [2:0] INIT_ODT_FORCE_RANK — Rank selection when 'init_odt_force_en' is asserted.
0x4300 CFG_PHYUPD_ACK_DELAY
  [9:0] CFG_PHYUPD_ACK_DELAY — Delay in DFI clocks before the dfi_phyupd_ack signal is asserted. The delay is measured from the time the DFI bus is idle after receiving a dfi_phyupd_req, providing additional margin between the request and acknowledge.
0x4304 CFG_MIRROR_X16_BG0_BG1
  [0] CFG_MIRROR_X16_BG0_BG1 — For DDR4 DIMMs populated with x16 devices, when set to 1'b1 will force mirroring of bank group bits BG0/1 when address mirroring is enabled for those ranks. Normally x16 devices do not have BG1 so the bank group bits are not mirrored. However, some PHY or DIMM applications may still require mirroring of the bank group bits.
0x4308 INIT_PDA_MR_W_REQ
  [0] INIT_PDA_MR_W_REQ — Per-DRAM addressability mode register write request. Initiates mode register write to the mode register specified by init_mr_addr, rank specified by init_cs, and devices selected by init_pda_nibble_select. The data to be written to the mode register is specified using init_mr_wr_data and init_mr_wr_mask. Assertion of init_ack signals completion of the operation.
