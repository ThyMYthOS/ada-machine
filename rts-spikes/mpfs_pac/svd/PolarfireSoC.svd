# Polarfire SoC register map
Vendor: Microchip; File version: 1.0
Polarfire SoC Register Description
CPU: Microchip PolarFire SoC 1.0, little endian
Registers are 32-bit, read-write, reset 0x0 unless marked. A register's access mark holds for its fields unless they carry their own. Offsets are from the block's base; lines under a group give offsets from that group; [hi:lo] are bit positions; {n}, {i} and the like mark numbered series; 'fields as' and 'values as' point back to an identical list; <NAME> marks a mode.

## Memory map
0x01700000 BUS_ERROR_UNIT_H0 — MSS Bus Error Unit H0
0x01701000 BUS_ERROR_UNIT_H1 — MSS Bus Error Unit H1
0x01702000 BUS_ERROR_UNIT_H2 — MSS Bus Error Unit H2
0x01703000 BUS_ERROR_UNIT_H3 — MSS Bus Error Unit H3
0x01704000 BUS_ERROR_UNIT_H4 — MSS Bus Error Unit H4
0x02010000 CACHE_CTRL — Cache Controller
0x20000000 MMUART0_LO — MMUART0_LO Controller
0x20001000 WDOG0_LO — WDOG0_LO Controller
0x20002000 SYSREG — SYSREG Controller
0x20003000 SCB_REGS — SCB_REGS Controller
0x20004000 AXISWITCH15X9_DW_AXI — AXISWITCH15X9_DW_AXI Controller
0x20005000 MPUCFG — MPUCFG Controller
0x20006000 FRQMETER — FRQMETER Controller
0x20007000 CFG_DDR_SGMII_PHY — CFG_DDR_SGMII_PHY Controller
0x20008000 EMMC_SD — EMMC_SD Controller
0x20082400 DDR_CSR_APB — DDR_CSR_APB Controller
0x20100000 MMUART1_LO — MMUART1_LO Controller
0x20101000 WDOG1_LO — WDOG1_LO Controller
0x20102000 MMUART2_LO — MMUART2_LO Controller
0x20103000 WDOG2_LO — WDOG2_LO Controller
0x20104000 MMUART3_LO — MMUART3_LO Controller
0x20105000 WDOG3_LO — WDOG3_LO Controller
0x20106000 MMUART4_LO — MMUART4_LO Controller
0x20107000 WDOG4_LO — WDOG4_LO Controller
0x20108000 SPI_A_LO — SPI_A_LO Controller
0x20109000 SPI_B_LO — SPI_B_LO Controller
0x2010A000 I2C_A_LO — I2C_A_LO Controller
0x2010B000 I2C_B_LO — I2C_B_LO Controller
0x2010C000 CAN_A_LO — CAN_A_LO Controller
0x2010D000 CAN_B_LO — CAN_B_LO Controller
0x20110000 GEM_A_LO — GEM_A_LO Controller
0x20112000 GEM_B_LO — GEM_B_LO Controller
0x20120000 GPIO_IOBANK0_LO — GPIO_IOBANK0_LO Controller
0x20121000 GPIO_IOBANK1_LO — GPIO_IOBANK1_LO Controller
0x20122000 GPIO_FAB_LO — GPIO_FAB_LO Controller
0x20124000 MSRTC_LO — MSRTC_LO Controller
0x20125000 MSTIMER_LO — MSTIMER_LO Controller
0x20126000 H2FINT_LO — H2FINT_LO Controller
0x20127000 CRYPTO — CRYPTO Controller
0x20200000 ENVM — ENVM Controller
0x20201000 USB — MSS USB 2.0 OTG High-Speed Controller
0x21000000 QSPIXIP — QSPIXIP Controller
0x22006000 ATHENA — ATHENA Controller
0x23000000 TRACE — TRACE Controller
0x28000000 MMUART0_HI — MMUART0_HI Controller
0x28001000 WDOG0_HI — WDOG0_HI Controller
0x28100000 MMUART1_HI — MMUART1_HI Controller
0x28101000 WDOG1_HI — WDOG1_HI Controller
0x28102000 MMUART2_HI — MMUART2_HI Controller
0x28103000 WDOG2_HI — WDOG2_HI Controller
0x28104000 MMUART3_HI — MMUART3_HI Controller
0x28105000 WDOG3_HI — WDOG3_HI Controller
0x28106000 MMUART4_HI — MMUART4_HI Controller
0x28107000 WDOG4_HI — WDOG4_HI Controller
0x28108000 SPI_A_HI — SPI_A_HI Controller
0x28109000 SPI_B_HI — SPI_B_HI Controller
0x2810A000 I2C_A_HI — I2C_A_HI Controller
0x2810B000 I2C_B_HI — I2C_B_HI Controller
0x2810C000 CAN_A_HI — CAN_A_HI Controller
0x2810D000 CAN_B_HI — CAN_B_HI Controller
0x28110000 GEM_A_HI — GEM_A_HI Controller
0x28112000 GEM_B_HI — GEM_B_HI Controller
0x28120000 GPIO_IOBANK0_HI — GPIO_IOBANK0_HI Controller
0x28121000 GPIO_IOBANK1_HI — GPIO_IOBANK1_HI Controller
0x28122000 GPIO_FAB_HI — GPIO_FAB_HI Controller
0x28124000 MSRTC_HI — MSRTC_HI Controller
0x28125000 MSTIMER_HI — MSTIMER_HI Controller
0x28126000 H2FINT_HI — H2FINT_HI Controller
0x37080000 IOSCBCFG — IOSCBCFG Controller
0x3E001000 IOSCB_PLL_MSS — IOSCB MSS PLL Controller
0x3E002000 IOSCB_MUX_MSS — IOSCB MSS Clock Management Controller
0x3E010000 IOSCB_PLL_DDR — IOSCB DDR PLL Controller
0x3E040000 IOSCB_IO_CALIB_DDR — IOSCB DDR IO Calibration Controller
0x3E080000 IOSCB_PLL_SGMII — IOSCB SGMII PLL Controller
0x3E200000 IOSCB_MUX_SGMII — IOSCB SGMII Clock Management Controller
0x3E800000 IOSCB_IO_CALIB_SGMII — IOSCB SGMII IO Calibration Controller
